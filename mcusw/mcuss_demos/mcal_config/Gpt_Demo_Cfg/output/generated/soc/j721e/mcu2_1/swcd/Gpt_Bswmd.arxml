AUTOSAR XML (schema 4-3-1)
package /AUTOSAR/Gpt/BswModuleDescriptions
  bsw module description Gpt: module-id=100
    provided-entrys:
      Gpt_GetVersionInfo
      Gpt_Init
      Gpt_DeInit
      Gpt_GetTimeElapsed
      Gpt_GetTimeRemaining
      Gpt_StartTimer
      Gpt_StopTimer
      Gpt_EnableNotification
      Gpt_DisableNotification
      Gpt_SetMode
      Gpt_DisableWakeup
      Gpt_EnableWakeup
      Gpt_CheckWakeup
      Gpt_GetPredefTimerValue
      Gpt_Ch{1..16}Isr
    bsw module dependency Dem: target-module-id=54, required-entrys=Dem_ReportErrorStatus
    bsw module dependency Det: target-module-id=15, required-entrys=Det_ReportError
    bsw internal behavior InternalBehaviour_0
      exclusive area GPT_EXCLUSIVE_AREA_0
      14 x bsw called entity:
        Gpt_GetVersionInfo: sw-addr-method=CODE_SLOW, implemented-entry=Gpt_GetVersionInfo
        Gpt_Init: reentrancy-level=NON-REENTRANT, sw-addr-method=CODE, implemented-entry=Gpt_Init
        Gpt_DeInit: reentrancy-level=NON-REENTRANT, sw-addr-method=CODE, implemented-entry=Gpt_DeInit
        Gpt_GetTimeElapsed: sw-addr-method=CODE, implemented-entry=Gpt_GetTimeElapsed
        Gpt_GetTimeRemaining: sw-addr-method=CODE, implemented-entry=Gpt_GetTimeRemaining
        Gpt_StartTimer: sw-addr-method=CODE, implemented-entry=Gpt_StartTimer
        Gpt_StopTimer: reentrancy-level=NON-REENTRANT, sw-addr-method=CODE, implemented-entry=Gpt_StopTimer
        Gpt_EnableNotification: sw-addr-method=CODE, implemented-entry=Gpt_EnableNotification
        Gpt_DisableNotification: sw-addr-method=CODE, implemented-entry=Gpt_DisableNotification
        Gpt_SetMode: sw-addr-method=CODE, implemented-entry=Gpt_SetMode
        Gpt_DisableWakeup: sw-addr-method=CODE, implemented-entry=Gpt_DisableWakeup
        Gpt_EnableWakeup: sw-addr-method=CODE, implemented-entry=Gpt_EnableWakeup
        Gpt_CheckWakeup: sw-addr-method=CODE, implemented-entry=Gpt_CheckWakeup
        Gpt_GetPredefTimerValue: sw-addr-method=CODE, implemented-entry=Gpt_GetPredefTimerValue
      16 x bsw interrupt entity, all with reentrancy-level=NON-REENTRANT, sw-addr-method=CODE_FAST, interrupt-category=CAT-1:
        Gpt_Ch{1..6}Isr: implemented-entry=Gpt_Ch{1..6}Isr
        Gpt_Ch16Isr: implemented-entry=Gpt_Ch16Isr
        Gpt_Ch{7..15}Isr: implemented-entry=Gpt_Ch{7..15}Isr
package /AUTOSAR/Gpt/BswModuleEntries
  30 x bsw module entry, all with is-synchronous=true, sw-service-impl-policy=STANDARD:
    Gpt_GetVersionInfo: service-id=0x00, is-reentrant=true, call-type=REGULAR, execution-context=TASK
    Gpt_Init: service-id=0x01, is-reentrant=false, call-type=REGULAR, execution-context=TASK
    Gpt_DeInit: service-id=0x02, is-reentrant=false, call-type=REGULAR, execution-context=TASK
    Gpt_GetTimeElapsed: service-id=0x03, is-reentrant=true, call-type=REGULAR, execution-context=UNSPECIFIED
    Gpt_GetTimeRemaining: service-id=0x04, is-reentrant=true, call-type=REGULAR, execution-context=UNSPECIFIED
    Gpt_StartTimer: service-id=0x05, is-reentrant=true, call-type=REGULAR, execution-context=UNSPECIFIED
    Gpt_StopTimer: service-id=0x06, is-reentrant=true, call-type=REGULAR, execution-context=UNSPECIFIED
    Gpt_EnableNotification: service-id=0x07, is-reentrant=true, call-type=REGULAR, execution-context=TASK
    Gpt_DisableNotification: service-id=0x08, is-reentrant=true, call-type=REGULAR, execution-context=TASK
    Gpt_SetMode: service-id=0x09, is-reentrant=false, call-type=REGULAR, execution-context=TASK
    Gpt_DisableWakeup: service-id=0x0a, is-reentrant=true, call-type=REGULAR, execution-context=TASK
    Gpt_EnableWakeup: service-id=0x0b, is-reentrant=true, call-type=REGULAR, execution-context=TASK
    Gpt_CheckWakeup: service-id=0x0c, is-reentrant=true, call-type=REGULAR, execution-context=TASK
    Gpt_GetPredefTimerValue: service-id=0x0d, is-reentrant=true, call-type=REGULAR, execution-context=TASK
    Gpt_Ch{1..16}Isr: is-reentrant=false, call-type=INTERRUPT, execution-context=INTERRUPT-CAT-1
package /TI_TDAXX/Gpt
  bsw implementation TI_TDAXX_Gpt: programming-language=C, sw-version=1.9.0, vendor-id=44, ar-release-version=4.2.1, vendor-specific-module-def=GPT
    code-descriptors:
      code Files
        artifact-descriptors:
          short-label=Gpt.c, category=SWSRC
          short-label=Gpt_Irq.c, category=SWSRC
          short-label=Gpt_Gptimer.c, category=SWSRC
          short-label=Gpt_PBcfg.c, category=SWSRC
    compiler armcl: name=TI ARM Compiler, options=-c -qq --endian=little -mv7M4 --float_support=vfplib --abi=eabi -eo.oem4 -ea.sem4 --symdebug:dwarf --embed_inline_assembly --gcc --emit_warnings_as_errors -g -ms --opt_level=3 -os --optimize_with_debug, vendor=Texas Instruments, version=5.2.5
    linker armcl: name=TI ARM Linker, vendor=Texas Instruments, version=5.2.5
    required-artifacts:
      dependency on artifact ExternalLibs: artifact-descriptor={short-label=libc, category=SWLIB}, usages=[LINK, COMPILE]
    resource consumption TI_TDAXX_Gpt_Resources
      8 x memory section:
        CONFIG_DATA: alignment=UNSPECIFIED, size=192, sw-addrmethod=CONFIG_DATA
        CODE: alignment=UNSPECIFIED, executable-entity=[Gpt_GetVersionInfo, Gpt_Init, Gpt_DeInit, Gpt_GetTimeElapsed, Gpt_GetTimeRemaining, Gpt_StartTimer, Gpt_StopTimer, Gpt_EnableNotification, Gpt_DisableNotification, Gpt_SetMode, Gpt_DisableWakeup, Gpt_EnableWakeup, Gpt_CheckWakeup, Gpt_GetPredefTimerValue], size=0x2000, sw-addrmethod=CODE
        VAR_INIT_UNSPECIFIED: alignment=UNSPECIFIED, size=32, sw-addrmethod=VAR
        VAR_NOINIT_UNSPECIFIED: alignment=UNSPECIFIED, size=256, sw-addrmethod=VAR
        CONST_UNSPECIFIED: alignment=UNSPECIFIED, size=64, sw-addrmethod=CONST
        ISR_CODE: alignment=UNSPECIFIED, size=1024, sw-addrmethod=CODE
        CONST_32: alignment=32, size=32, sw-addrmethod=CONST
        CODE_ISR: alignment=UNSPECIFIED, executable-entity=[Gpt_Ch10Isr, Gpt_Ch11Isr, Gpt_Ch12Isr, Gpt_Ch13Isr, Gpt_Ch14Isr, Gpt_Ch15Isr, Gpt_Ch16Isr, Gpt_Ch1Isr, Gpt_Ch2Isr, Gpt_Ch3Isr, Gpt_Ch4Isr, Gpt_Ch5Isr, Gpt_Ch6Isr, Gpt_Ch7Isr, Gpt_Ch8Isr, Gpt_Ch9Isr], size=1024, sw-addrmethod=CODE_FAST
      29 x measured stack usage:
        Gpt_GetVersionInfo_Stack: executable-entity=Gpt_GetVersionInfo, average-memory-consumption=16, maximum-memory-consumption=16, minimum-memory-consumption=16
        Gpt_Init_Stack: executable-entity=Gpt_Init, average-memory-consumption=120, maximum-memory-consumption=120, minimum-memory-consumption=120
        Gpt_DeInit_Stack: executable-entity=Gpt_DeInit, average-memory-consumption=88, maximum-memory-consumption=88, minimum-memory-consumption=88
        Gpt_GetTimeElapsed_Stack: executable-entity=Gpt_GetTimeElapsed, average-memory-consumption=64, maximum-memory-consumption=64, minimum-memory-consumption=64
        Gpt_GetTimeRemaining_Stack: executable-entity=Gpt_GetTimeRemaining, average-memory-consumption=56, maximum-memory-consumption=56, minimum-memory-consumption=56
        Gpt_StartTimer_Stack: executable-entity=Gpt_StartTimer, average-memory-consumption=88, maximum-memory-consumption=88, minimum-memory-consumption=88
        Gpt_StopTimer_Stack: executable-entity=Gpt_StopTimer, average-memory-consumption=56, maximum-memory-consumption=56, minimum-memory-consumption=56
        Gpt_EnableNotification_Stack: executable-entity=Gpt_EnableNotification, average-memory-consumption=48, maximum-memory-consumption=48, minimum-memory-consumption=48
        Gpt_DisableNotification_Stack: executable-entity=Gpt_DisableNotification, average-memory-consumption=48, maximum-memory-consumption=48, minimum-memory-consumption=48
        Gpt_SetMode_Stack: executable-entity=Gpt_SetMode, average-memory-consumption=80, maximum-memory-consumption=80, minimum-memory-consumption=80
        Gpt_DisableWakeup_Stack: executable-entity=Gpt_DisableWakeup, average-memory-consumption=56, maximum-memory-consumption=56, minimum-memory-consumption=56
        Gpt_EnableWakeup_Stack: executable-entity=Gpt_EnableWakeup, average-memory-consumption=48, maximum-memory-consumption=48, minimum-memory-consumption=48
        Gpt_CheckWakeup_Stack: executable-entity=Gpt_CheckWakeup, average-memory-consumption=32, maximum-memory-consumption=32, minimum-memory-consumption=32
        Gpt_Ch2Isr_Stack: executable-entity=Gpt_Ch2Isr, average-memory-consumption=56, maximum-memory-consumption=56, minimum-memory-consumption=56
        Gpt_Ch1Isr_Stack: executable-entity=Gpt_Ch1Isr, average-memory-consumption=56, maximum-memory-consumption=56, minimum-memory-consumption=56
        Gpt_Ch{3..16}Isr_Stack: executable-entity=Gpt_Ch{3..16}Isr, average-memory-consumption=56, maximum-memory-consumption=56, minimum-memory-consumption=56
