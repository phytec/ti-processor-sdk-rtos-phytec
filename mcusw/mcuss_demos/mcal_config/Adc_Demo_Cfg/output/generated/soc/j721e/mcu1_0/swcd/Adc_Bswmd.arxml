AUTOSAR XML (schema 4-2-1)
package /AUTOSAR/Adc/BswModuleDescriptions
  bsw module description Adc: module-id=123
    provided-entrys:
      Adc_Init
      Adc_DeInit
      Adc_SetupResultBuffer
      Adc_GetGroupStatus
      Adc_GetStreamLastPointer
      Adc_StartGroupConversion
      Adc_StopGroupConversion
      Adc_ReadGroup
      Adc_EnableGroupNotification
      Adc_DisableGroupNotification
      Adc_GetVersionInfo
      Adc_IrqUnit1
    bsw module dependency Det: target-module-id=15, required-entrys=Det_ReportError
    bsw internal behavior InternalBehaviour_0
      exclusive area ADC_EXCLUSIVE_AREA_0
      11 x bsw called entity:
        Adc_Init: reentrancy-level=NON-REENTRANT, sw-addr-method=CODE_SLOW, implemented-entry=Adc_Init
          bsw direct call point Det_ReportError: called-entry=Det_ReportError
        Adc_DeInit: can-enter-exclusive-area=ADC_EXCLUSIVE_AREA_0, reentrancy-level=NON-REENTRANT, sw-addr-method=CODE, implemented-entry=Adc_DeInit
          bsw direct call point Det_ReportError: called-entry=Det_ReportError
        Adc_SetupResultBuffer: can-enter-exclusive-area=ADC_EXCLUSIVE_AREA_0, reentrancy-level=SINGLE-CORE-REENTRANT, sw-addr-method=CODE, implemented-entry=Adc_SetupResultBuffer
          bsw direct call point Det_ReportError: called-entry=Det_ReportError
        Adc_GetGroupStatus: can-enter-exclusive-area=ADC_EXCLUSIVE_AREA_0, reentrancy-level=SINGLE-CORE-REENTRANT, sw-addr-method=CODE, implemented-entry=Adc_GetGroupStatus
          bsw direct call point Det_ReportError: called-entry=Det_ReportError
        Adc_GetStreamLastPointer: can-enter-exclusive-area=ADC_EXCLUSIVE_AREA_0, reentrancy-level=SINGLE-CORE-REENTRANT, sw-addr-method=CODE, implemented-entry=Adc_GetStreamLastPointer
        Adc_StartGroupConversion: can-enter-exclusive-area=ADC_EXCLUSIVE_AREA_0, reentrancy-level=SINGLE-CORE-REENTRANT, sw-addr-method=CODE, implemented-entry=Adc_StartGroupConversion
          bsw direct call point Det_ReportError: called-entry=Det_ReportError
        Adc_StopGroupConversion: can-enter-exclusive-area=ADC_EXCLUSIVE_AREA_0, reentrancy-level=SINGLE-CORE-REENTRANT, sw-addr-method=CODE, implemented-entry=Adc_StopGroupConversion
          bsw direct call point Det_ReportError: called-entry=Det_ReportError
        Adc_ReadGroup: can-enter-exclusive-area=ADC_EXCLUSIVE_AREA_0, reentrancy-level=SINGLE-CORE-REENTRANT, sw-addr-method=CODE, implemented-entry=Adc_ReadGroup
          bsw direct call point Det_ReportError: called-entry=Det_ReportError
        Adc_EnableGroupNotification: can-enter-exclusive-area=ADC_EXCLUSIVE_AREA_0, reentrancy-level=SINGLE-CORE-REENTRANT, sw-addr-method=CODE, implemented-entry=Adc_EnableGroupNotification
          bsw direct call point Det_ReportError: called-entry=Det_ReportError
        Adc_DisableGroupNotification: can-enter-exclusive-area=ADC_EXCLUSIVE_AREA_0, reentrancy-level=SINGLE-CORE-REENTRANT, sw-addr-method=CODE, implemented-entry=Adc_DisableGroupNotification
          bsw direct call point Det_ReportError: called-entry=Det_ReportError
        Adc_GetVersionInfo: reentrancy-level=SINGLE-CORE-REENTRANT, sw-addr-method=CODE, implemented-entry=Adc_GetVersionInfo
          bsw direct call point Det_ReportError: called-entry=Det_ReportError
      bsw interrupt entity Adc_IrqUnit1: reentrancy-level=NON-REENTRANT, implemented-entry=Adc_IrqUnit1, interrupt-category=CAT-1
package /AUTOSAR/Adc/BswModuleEntries
  12 x bsw module entry, all with sw-service-impl-policy=STANDARD:
    Adc_Init: service-id=0x00, is-reentrant=false, is-synchronous=true, call-type=REGULAR, execution-context=TASK
    Adc_DeInit: service-id=0x01, is-reentrant=false, is-synchronous=true, call-type=REGULAR, execution-context=TASK
    Adc_SetupResultBuffer: service-id=0x0c, is-reentrant=true, is-synchronous=true, call-type=REGULAR, execution-context=TASK
    Adc_GetGroupStatus: service-id=0x09, is-reentrant=true, is-synchronous=true, call-type=REGULAR, execution-context=UNSPECIFIED
    Adc_GetStreamLastPointer: service-id=0x0b, is-reentrant=true, is-synchronous=true, call-type=REGULAR, execution-context=TASK
    Adc_StartGroupConversion: service-id=0x02, is-reentrant=true, is-synchronous=false, call-type=REGULAR, execution-context=UNSPECIFIED
    Adc_StopGroupConversion: service-id=0x03, is-reentrant=true, is-synchronous=true, call-type=REGULAR, execution-context=UNSPECIFIED
    Adc_ReadGroup: service-id=0x04, is-reentrant=true, is-synchronous=true, call-type=REGULAR, execution-context=TASK
    Adc_EnableGroupNotification: service-id=0x07, is-reentrant=true, is-synchronous=true, call-type=REGULAR, execution-context=TASK
    Adc_DisableGroupNotification: service-id=0x08, is-reentrant=true, is-synchronous=true, call-type=REGULAR, execution-context=TASK
    Adc_GetVersionInfo: service-id=0x0a, is-reentrant=true, is-synchronous=true, call-type=REGULAR, execution-context=TASK
    Adc_IrqUnit1: is-reentrant=false, is-synchronous=true, call-type=INTERRUPT, execution-context=INTERRUPT-CAT-1
package /AUTOSAR/Det/BswModuleEntries
  bsw module entry Det_ReportError: service-id=1, call-type=REGULAR, execution-context=UNSPECIFIED
package /TI_TDAXX/Adc
  bsw implementation TI_TDAXX_Adc: programming-language=C, sw-version=1.10.0, used-code-generator=EB Tresos, vendor-id=44, ar-release-version=4.2.1, behavior=InternalBehaviour_0, vendor-specific-module-def=ADC
    code-descriptors:
      code Files
        artifact-descriptors:
          short-label=Adc.c, category=SWSRC
          short-label=Adc_Irq.c, category=SWSRC
          short-label=Adc_Priv.c, category=SWSRC
          short-label=Adc_Utils.c, category=SWSRC
          short-label=Adc_PBcfg.c, category=SWSRC
    compiler armcl: name=TI ARM Compiler, options=-c -qq --endian=little -mv7M4 --float_support=vfplib --abi=eabi -eo.oem4 -ea.sem4 --symdebug:dwarf --embed_inline_assembly --gcc --emit_warnings_as_errors -g -ms --opt_level=3 -os --optimize_with_debug, vendor=Texas Instruments, version=5.2.5
    linker armcl: name=TI ARM Linker, vendor=Texas Instruments, version=5.2.5
    required-artifacts:
      dependency on artifact ExternalLibs: artifact-descriptor={short-label=libc, category=SWLIB}, usages=[LINK, COMPILE]
    resource consumption TI_TDAXX_Adc_Resources
      4 x memory section, all with alignment=UNSPECIFIED:
        CONFIG_DATA: size=1024, sw-addrmethod=CONFIG_DATA
        CODE: executable-entity=[Adc_Init, Adc_DeInit, Adc_SetupResultBuffer, Adc_GetGroupStatus, Adc_GetStreamLastPointer, Adc_StartGroupConversion, Adc_StopGroupConversion, Adc_ReadGroup, Adc_EnableGroupNotification, Adc_DisableGroupNotification, Adc_GetVersionInfo], size=0x2af8, sw-addrmethod=CODE
        VAR_INIT_UNSPECIFIED: size=64, sw-addrmethod=VAR
        VAR_NOINIT_UNSPECIFIED: size=8192, sw-addrmethod=VAR
      11 x measured stack usage:
        Adc_Init_Stack: executable-entity=Adc_Init, average-memory-consumption=120, maximum-memory-consumption=120, minimum-memory-consumption=120
        Adc_DeInit_Stack: executable-entity=Adc_DeInit, average-memory-consumption=64, maximum-memory-consumption=64, minimum-memory-consumption=64
        Adc_SetupResultBuffer_Stack: executable-entity=Adc_SetupResultBuffer, average-memory-consumption=32, maximum-memory-consumption=32, minimum-memory-consumption=32
        Adc_GetGroupStatus_Stack: executable-entity=Adc_GetGroupStatus, average-memory-consumption=24, maximum-memory-consumption=24, minimum-memory-consumption=24
        Adc_GetStreamLastPointer_Stack: executable-entity=Adc_GetStreamLastPointer, average-memory-consumption=64, maximum-memory-consumption=64, minimum-memory-consumption=64
        Adc_StartGroupConversion_Stack: executable-entity=Adc_StartGroupConversion, average-memory-consumption=136, maximum-memory-consumption=136, minimum-memory-consumption=136
        Adc_StopGroupConversion_Stack: executable-entity=Adc_StopGroupConversion, average-memory-consumption=136, maximum-memory-consumption=136, minimum-memory-consumption=136
        Adc_ReadGroup_Stack: executable-entity=Adc_ReadGroup, average-memory-consumption=48, maximum-memory-consumption=48, minimum-memory-consumption=48
        Adc_EnableGroupNotification_Stack: executable-entity=Adc_EnableGroupNotification, average-memory-consumption=24, maximum-memory-consumption=24, minimum-memory-consumption=24
        Adc_DisableGroupNotification_Stack: executable-entity=Adc_DisableGroupNotification, average-memory-consumption=24, maximum-memory-consumption=24, minimum-memory-consumption=24
        Adc_GetVersionInfo_Stack: executable-entity=Adc_GetVersionInfo, average-memory-consumption=16, maximum-memory-consumption=16, minimum-memory-consumption=16
