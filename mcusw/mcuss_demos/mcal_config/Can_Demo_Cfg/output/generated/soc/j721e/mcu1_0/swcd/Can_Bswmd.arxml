AUTOSAR XML (schema 4-2-1)
package /AUTOSAR/Can/BswModuleDescriptions
  bsw module description Can: module-id=80
    provided-entrys:
      Can_0_Int0ISR
      Can_0_Int0ISR_Fun
      Can_0_Int1ISR
      Can_0_Int1ISR_Fun
      Can_1_Int0ISR
      Can_1_Int0ISR_Fun
      Can_1_Int1ISR
      Can_1_Int1ISR_Fun
      Can_2_Int0ISR
      Can_2_Int0ISR_Fun
      Can_2_Int1ISR
      Can_2_Int1ISR_Fun
      Can_ChangeBaudrate
      Can_CheckBaudrate
      Can_SetBaudrate
      Can_CheckWakeup
      Can_DisableControllerInterrupts
      Can_EnableControllerInterrupts
      Can_Init
      Can_MainFunction_Mode
      Can_SetControllerMode
      Can_Write
    bsw module dependency Dem: target-module-id=54, required-entrys=Dem_ReportErrorStatus
    bsw module dependency EcuM: target-module-id=10, expected-callbacks=EcuM_CheckWakeup
    bsw module dependency CanIf: target-module-id=60, expected-callbacks=CanIf_ControllerModeIndication
    bsw internal behavior InternalBehaviour_0
      exclusive area CAN_EXCLUSIVE_AREA_0
      bsw called entity Can_Init: reentrancy-level=NON-REENTRANT, sw-addr-method=CODE_SLOW, implemented-entry=Can_Init
      5 x bsw schedulable entity, all with reentrancy-level=SINGLE-CORE-REENTRANT:
        Can_MainFunction_Write: sw-addr-method=CODE, implemented-entry=Can_MainFunction_Write
          bsw direct call point CanIf_TxConfirmation: called-entry=CanIf_TxConfirmation
        Can_MainFunction_Read: sw-addr-method=CODE, implemented-entry=Can_MainFunction_Read
          bsw direct call point CanIf_RxIndication: called-entry=CanIf_RxIndication
        Can_MainFunction_Mode: sw-addr-method=CODE, implemented-entry=Can_MainFunction_Mode
          bsw direct call point CanIf_ControllerModeIndication: called-entry=CanIf_ControllerModeIndication
        Can_MainFunction_BusOff: implemented-entry=Can_MainFunction_BusOff
          bsw direct call point CanIf_ControllerBusOff: called-entry=CanIf_ControllerBusOff
        Can_MainFunction_Wakeup: sw-addr-method=CODE, implemented-entry=Can_MainFunction_Wakeup
          bsw direct call point EcuM_CheckWakeup: called-entry=EcuM_CheckWakeup
      10 x bsw called entity:
        Can_ChangeBaudRate: reentrancy-level=NON-REENTRANT, sw-addr-method=CODE, implemented-entry=Can_ChangeBaudrate
        Can_CheckBaudRate: reentrancy-level=MULTICORE-REENTRANT, sw-addr-method=CODE, implemented-entry=Can_CheckBaudrate
        Can_CheckWakeup: reentrancy-level=SINGLE-CORE-REENTRANT, sw-addr-method=CODE, implemented-entry=Can_CheckWakeup
        Can_DisableControllerInterrupts: can-enter-exclusive-area=CAN_EXCLUSIVE_AREA_0, reentrancy-level=SINGLE-CORE-REENTRANT, sw-addr-method=CODE, implemented-entry=Can_DisableControllerInterrupts
        Can_EnableControllerInterrupts: can-enter-exclusive-area=CAN_EXCLUSIVE_AREA_0, reentrancy-level=SINGLE-CORE-REENTRANT, sw-addr-method=CODE, implemented-entry=Can_EnableControllerInterrupts
        Can_TestLoopBackModeEnable: reentrancy-level=NON-REENTRANT, sw-addr-method=CODE_SLOW, implemented-entry=Can_TestLoopBackModeEnable
        Can_DisableControllerInterrupts: reentrancy-level=NON-REENTRANT, sw-addr-method=CODE_SLOW, implemented-entry=Can_DisableControllerInterrupts
        Can_SetControllerMode: reentrancy-level=NON-REENTRANT, sw-addr-method=CODE_SLOW, implemented-entry=Can_SetControllerMode
          bsw direct call point CanIf_ControllerModeIndication: called-entry=CanIf_ControllerModeIndication
        Can_TestLoopBackModeDisable: reentrancy-level=NON-REENTRANT, sw-addr-method=CODE_SLOW, implemented-entry=Can_TestLoopBackModeDisable
        Can_Write: can-enter-exclusive-area=CAN_EXCLUSIVE_AREA_0, reentrancy-level=SINGLE-CORE-REENTRANT, sw-addr-method=CODE, implemented-entry=Can_Write
      12 x bsw interrupt entity, all with reentrancy-level=NON-REENTRANT, sw-addr-method=CODE_FAST, interrupt-category=CAT-1:
        Can_0_Int0ISR: implemented-entry=Can_0_Int0ISR
          bsw direct call point Can_0_Int0ISR_Fun: called-entry=Can_0_Int0ISR_Fun
        Can_1_Int0ISR: implemented-entry=Can_1_Int0ISR
          bsw direct call point Can_1_Int0ISR_Fun: called-entry=Can_1_Int0ISR_Fun
        Can_1_Int1ISR: implemented-entry=Can_1_Int1ISR
          bsw direct call point Can_1_Int1ISR_Fun: called-entry=Can_1_Int1ISR_Fun
        Can_0_Int0ISR_Fun: implemented-entry=Can_0_Int1ISR_Fun
          4 x bsw direct call point:
            EcuM_CheckWakeup: called-entry=EcuM_CheckWakeup
            CanIf_ControllerBusOff: called-entry=CanIf_ControllerBusOff
            CanIf_RxIndication: called-entry=CanIf_RxIndication
            CanIf_txConfirmation: called-entry=CanIf_TxConfirmation
        Can_0_Int1ISR_Fun: implemented-entry=Can_1_Int0ISR_Fun
          4 x bsw direct call point:
            EcuM_CheckWakeup: called-entry=EcuM_CheckWakeup
            CanIf_ControllerBusOff: called-entry=CanIf_ControllerBusOff
            CanIf_RxIndication: called-entry=CanIf_RxIndication
            CanIf_txConfirmation: called-entry=CanIf_TxConfirmation
        Can_1_Int0ISR_Fun: implemented-entry=Can_1_Int0ISR_Fun
          4 x bsw direct call point:
            EcuM_CheckWakeup: called-entry=EcuM_CheckWakeup
            CanIf_ControllerBusOff: called-entry=CanIf_ControllerBusOff
            CanIf_RxIndication: called-entry=CanIf_RxIndication
            CanIf_txConfirmation: called-entry=CanIf_TxConfirmation
        Can_1_Int1ISR_Fun: implemented-entry=Can_1_Int1ISR_Fun
          4 x bsw direct call point:
            EcuM_CheckWakeup: called-entry=EcuM_CheckWakeup
            CanIf_ControllerBusOff: called-entry=CanIf_ControllerBusOff
            CanIf_RxIndication: called-entry=CanIf_RxIndication
            CanIf_txConfirmation: called-entry=CanIf_TxConfirmation
        Can_2_Int0ISR_Fun: implemented-entry=Can_2_Int0ISR_Fun
          4 x bsw direct call point:
            EcuM_CheckWakeup: called-entry=EcuM_CheckWakeup
            CanIf_ControllerBusOff: called-entry=CanIf_ControllerBusOff
            CanIf_RxIndication: called-entry=CanIf_RxIndication
            CanIf_txConfirmation: called-entry=CanIf_TxConfirmation
        Can_2_Int1ISR_Fun: implemented-entry=Can_2_Int1ISR_Fun
        Can_0_Int1ISR: implemented-entry=Can_0_Int1ISR
          bsw direct call point Can_0_Int1ISR_Fun: called-entry=Can_0_Int1ISR_Fun
        Can_2_Int0ISR: implemented-entry=Can_2_Int0ISR
          bsw direct call point Can_2_Int0ISR_Fun: called-entry=Can_2_Int0ISR_Fun
        Can_2_Int1ISR: implemented-entry=Can_2_Int1ISR
          bsw direct call point Can_2_Int1ISR_Fun: called-entry=Can_2_Int1ISR_Fun
      bsw called entity Can_GetVersionInfo: reentrancy-level=SINGLE-CORE-REENTRANT, sw-addr-method=CODE_SLOW, implemented-entry=Can_GetVersionInfo
      bsw called entity Can_RegisterReadback: reentrancy-level=NON-REENTRANT, sw-addr-method=CODE, implemented-entry=Can_RegisterReadback
      5 x bsw timing event:
        CanWriteTimingEvent_MainFunction: starts-on-event=Can_MainFunction_Write
        CanReadTimingEvent_MainFunction: starts-on-event=Can_MainFunction_Read
        CanWakeupTimingEvent_MainFunction: starts-on-event=Can_MainFunction_Wakeup
        CanModeTimingEvent_MainFunction: starts-on-event=Can_MainFunction_Mode
        CanBusOffTimingEvent_MainFunction: starts-on-event=Can_MainFunction_BusOff
package /AUTOSAR/Can/BswModuleEntries
  28 x bsw module entry, all with sw-service-impl-policy=STANDARD:
    Can_Init: service-id=0, is-reentrant=false, is-synchronous=true, call-type=REGULAR, execution-context=TASK
    Can_MainFunction_Write: service-id=1, is-reentrant=true, is-synchronous=true, call-type=SCHEDULED, execution-context=TASK
    Can_SetControllerMode: service-id=3, is-reentrant=false, is-synchronous=false, call-type=REGULAR, execution-context=TASK
    Can_Write: service-id=6, is-reentrant=true, is-synchronous=true, call-type=REGULAR, execution-context=UNSPECIFIED
    Can_CheckWakeup: service-id=0x0b, is-reentrant=false, is-synchronous=true, call-type=REGULAR, execution-context=UNSPECIFIED
    Can_DisableControllerInterrupts: service-id=0x04, is-reentrant=true, is-synchronous=true, call-type=REGULAR, execution-context=UNSPECIFIED
    Can_EnableControllerInterrupts: service-id=0x05, is-reentrant=true, is-synchronous=true, call-type=REGULAR, execution-context=UNSPECIFIED
    Can_MainFunction_BusOff: service-id=0x09, is-reentrant=false, is-synchronous=true, call-type=SCHEDULED, execution-context=TASK
    Can_MainFunction_Read: service-id=0x08, is-reentrant=false, is-synchronous=true, call-type=SCHEDULED, execution-context=TASK
    Can_MainFunction_Wakeup: service-id=0x0a, is-reentrant=false, is-synchronous=true, call-type=SCHEDULED, execution-context=TASK
    Can_MainFunction_Mode: service-id=0x0c, is-reentrant=false, is-synchronous=true, call-type=SCHEDULED, execution-context=TASK
    Can_ChangeBaudrate: service-id=0x0d, is-reentrant=false, is-synchronous=true, call-type=REGULAR, execution-context=UNSPECIFIED
    Can_0_Int0ISR_Fun: is-reentrant=false, is-synchronous=true, call-type=REGULAR, execution-context=INTERRUPT-CAT-2
    Can_1_Int0ISR_Fun: is-reentrant=false, is-synchronous=true, call-type=REGULAR, execution-context=INTERRUPT-CAT-2
    Can_0_Int1ISR_Fun: is-reentrant=false, is-synchronous=true, call-type=REGULAR, execution-context=INTERRUPT-CAT-2
    Can_1_Int1ISR_Fun: is-reentrant=false, is-synchronous=true, call-type=REGULAR, execution-context=INTERRUPT-CAT-2
    Can_0_Int0ISR: is-reentrant=false, is-synchronous=true, call-type=INTERRUPT, execution-context=INTERRUPT-CAT-1
    Can_1_Int0ISR: is-reentrant=false, is-synchronous=true, call-type=INTERRUPT, execution-context=INTERRUPT-CAT-1
    Can_0_Int1ISR: is-reentrant=false, is-synchronous=true, call-type=INTERRUPT, execution-context=INTERRUPT-CAT-1
    Can_1_Int1ISR: is-reentrant=false, is-synchronous=true, call-type=INTERRUPT, execution-context=INTERRUPT-CAT-1
    Can_2_Int0ISR: is-reentrant=false, is-synchronous=true, call-type=INTERRUPT, execution-context=INTERRUPT-CAT-1
    Can_2_Int1ISR: is-reentrant=false, is-synchronous=true, call-type=INTERRUPT, execution-context=INTERRUPT-CAT-1
    Can_CheckBaudrate: service-id=0x0e, is-reentrant=true, is-synchronous=true, call-type=REGULAR, execution-context=UNSPECIFIED
    Can_TestLoopBackModeEnable: service-id=0x0e, is-reentrant=false, is-synchronous=true, call-type=REGULAR, execution-context=UNSPECIFIED  # This service will enable CAN loopback mode
      sw service arg Controller: direction=IN, implementation-data-type=uint8  # CAN Controller to enable loopback mode
      sw service arg Mode: implementation-data-type=uint8  # Loopback mode
    Can_TestLoopBackModeDisable: is-reentrant=false, is-synchronous=true, call-type=REGULAR, execution-context=UNSPECIFIED  # This service will enable CAN loopback mode
      sw service arg Controller: direction=IN, implementation-data-type=uint8  # CAN Controller to enable loopback mode
      sw service arg Mode: implementation-data-type=uint8  # Loopback mode
    Can_GetVersionInfo: service-id=7, is-reentrant=true, is-synchronous=true, call-type=REGULAR, execution-context=TASK
    Can_RegisterReadback: service-id=13, is-reentrant=false, is-synchronous=true, call-type=REGULAR, execution-context=UNSPECIFIED
    Can_SetBaudrate: service-id=15, is-reentrant=false, is-synchronous=true, call-type=REGULAR, execution-context=UNSPECIFIED
package /AUTOSAR/Dem/BswModuleEntries
  bsw module entry Dem_ReportErrorStatus: service-id=15, call-type=REGULAR, execution-context=UNSPECIFIED, sw-service-impl-policy=STANDARD
package /AUTOSAR/Det/BswModuleEntries
  bsw module entry Det_ReportError: service-id=1, call-type=REGULAR, execution-context=UNSPECIFIED
package /AUTOSAR/EcuM/BswModuleEntries
  bsw module entry EcuM_CheckWakeup: service-id=12, call-type=CALLBACK, execution-context=UNSPECIFIED
package /AUTOSAR/CanIf/BswModuleEntries
  4 x bsw module entry, all with call-type=CALLBACK:
    CanIf_ControllerModeIndication: service-id=23
    CanIf_TxConfirmation: service-id=0x13
    CanIf_RxIndication: service-id=0x14
    CanIf_ControllerBusOff: service-id=0x16
package /TI_TDA3XX/Can
  bsw implementation TI_TDA3XX_Can: programming-language=C, sw-version=1.9.0, vendor-id=44, ar-release-version=4.2.1, vendor-specific-module-def=TI_TDA3XX/Can
    code-descriptors:
      code Files
        artifact-descriptors:
          short-label=Can.c, category=SWSRC
          short-label=Can_Irq.c, category=SWSRC
          short-label=Can_Dcan.c, category=SWSRC
          short-label=Can_Priv.c, category=SWSRC
          short-label=Can_PBcfg_tda3xx.c, category=SWSRC
          short-label=Can_Mcan.c, category=SWSRC
          short-label=mcan.c, category=SWSRC
    compiler armcl: name=TI ARM Compiler, options=-c -qq --endian=little -mv7M4 --float_support=vfplib --abi=eabi -eo.oem4 -ea.sem4 --symdebug:dwarf --embed_inline_assembly --gcc --emit_warnings_as_errors -g -ms --opt_level=3 -os --optimize_with_debug, vendor=Texas Instruments, version=5.2.5
    linker armcl: name=TI ARM Linker, vendor=Texas Instruments, version=5.2.5
    required-artifacts:
      dependency on artifact ExternalLibs: artifact-descriptor={short-label=libc, category=SWLIB}, usages=[LINK, COMPILE]
    resource consumption TI_TDA3XX_Can_Resources
      4 x measured execution time:
        Can_ISR_Time: executable-entity=Can_0_Int0ISR_Fun
        Can_Write_Time: exclusive-area=CAN_EXCLUSIVE_AREA_0, executable-entity=Can_Write
        Can_MainFunction_Write_Time: executable-entity=Can_MainFunction_Write
        Can_MainFunction_Read_Time: executable-entity=Can_MainFunction_Read
      10 x memory section:
        CONFIG_DATA: alignment=UNSPECIFIED, size=1024, sw-addrmethod=CONFIG_DATA
        CODE:
          alignment=UNSPECIFIED
          executable-entity=[Can_ChangeBaudRate, Can_CheckBaudRate, Can_CheckWakeup, InternalBehaviour_0/Can_DisableControllerInterrupts, Can_EnableControllerInterrupts, Can_Init, Can_MainFunction_BusOff, Can_MainFunction_Mode, Can_MainFunction_Read, Can_MainFunction_Wakeup, Can_MainFunction_Write, Can_SetControllerMode, Can_TestLoopBackModeDisable, Can_TestLoopBackModeEnable, Can_Write]
          size=0x5000
          sw-addrmethod=CODE
        VAR_INIT_UNSPECIFIED: alignment=UNSPECIFIED, size=256, sw-addrmethod=VAR
        VAR_NOINIT_UNSPECIFIED: alignment=UNSPECIFIED, size=1024, sw-addrmethod=VAR
        CONST_UNSPECIFIED: alignment=UNSPECIFIED, size=1024, sw-addrmethod=CONST
        ISR_CODE: alignment=UNSPECIFIED, executable-entity=[Can_0_Int0ISR, Can_0_Int1ISR, Can_1_Int0ISR, Can_1_Int1ISR, Can_2_Int0ISR, Can_2_Int1ISR, Can_0_Int0ISR_Fun, Can_0_Int1ISR_Fun, Can_1_Int0ISR_Fun, Can_1_Int1ISR_Fun, Can_2_Int0ISR_Fun, Can_2_Int1ISR_Fun], size=12288, sw-addrmethod=CODE
        CONST_32: alignment=32, size=512, sw-addrmethod=CONST
        VAR_NOINIT_16: alignment=16, size=1024, sw-addrmethod=VAR
        VAR_NOINIT_8: alignment=8, size=512, sw-addrmethod=VAR
        VAR_NOINIT_32: alignment=32, size=512, sw-addrmethod=VAR
      24 x measured stack usage:
        Can_ISR_Stack: executable-entity=Can_0_Int0ISR_Fun, average-memory-consumption=168, maximum-memory-consumption=168, minimum-memory-consumption=168
        Can_Write_Stack: executable-entity=Can_Write, average-memory-consumption=384, maximum-memory-consumption=384, minimum-memory-consumption=384
        Can_MainFunction_Read_Stack: executable-entity=Can_MainFunction_Read, average-memory-consumption=376, maximum-memory-consumption=376, minimum-memory-consumption=376
        Can_MainFunction_Write_Stack: executable-entity=Can_MainFunction_Write, average-memory-consumption=112, maximum-memory-consumption=112, minimum-memory-consumption=112
        Can_GetVersionInfo_Stack: executable-entity=Can_GetVersionInfo, average-memory-consumption=8, maximum-memory-consumption=8, minimum-memory-consumption=8
        Can_Init_Stack: executable-entity=Can_Init, average-memory-consumption=320, maximum-memory-consumption=320, minimum-memory-consumption=320
        Can_SetControllerMode_Stack: executable-entity=Can_SetControllerMode, average-memory-consumption=160, maximum-memory-consumption=160, minimum-memory-consumption=160
        Can_CheckWakeup_Stack: executable-entity=Can_CheckWakeup, average-memory-consumption=80, maximum-memory-consumption=80, minimum-memory-consumption=80
        Can_DisableControllerInterrupts_Stack: executable-entity=InternalBehaviour_0/Can_DisableControllerInterrupts, average-memory-consumption=80, maximum-memory-consumption=80, minimum-memory-consumption=80
        Can_EnableControllerInterrupts_Stack: executable-entity=Can_EnableControllerInterrupts, average-memory-consumption=80, maximum-memory-consumption=80, minimum-memory-consumption=80
        Can_MainFunction_BusOff_Stack: executable-entity=Can_MainFunction_BusOff, average-memory-consumption=112, maximum-memory-consumption=112, minimum-memory-consumption=112
        Can_MainFunction_Wakeup_Stack: executable-entity=Can_MainFunction_Wakeup, average-memory-consumption=72, maximum-memory-consumption=72, minimum-memory-consumption=72
        Can_MainFunction_Mode_Stack: executable-entity=Can_MainFunction_Mode, average-memory-consumption=128, maximum-memory-consumption=128, minimum-memory-consumption=128
        Can_ChangeBaudrate_Stack: executable-entity=Can_ChangeBaudRate, average-memory-consumption=328, maximum-memory-consumption=328, minimum-memory-consumption=328
        Can_CheckBaudrate_Stack: executable-entity=Can_CheckBaudRate, average-memory-consumption=40, maximum-memory-consumption=40, minimum-memory-consumption=40
        Can_TestLoopBackModeEnable_Stack: executable-entity=Can_TestLoopBackModeEnable, average-memory-consumption=120, maximum-memory-consumption=120, minimum-memory-consumption=120
        Can_TestLoopBackModeDisable_Stack: executable-entity=Can_TestLoopBackModeDisable, average-memory-consumption=120, maximum-memory-consumption=120, minimum-memory-consumption=120
        Can_RegisterReadback_Stack: executable-entity=Can_RegisterReadback, average-memory-consumption=32, maximum-memory-consumption=32, minimum-memory-consumption=32
        Can_EccParityEnable_Stack: executable-entity=Can_EccParityEnable, average-memory-consumption=112, maximum-memory-consumption=112, minimum-memory-consumption=112
        Can_EccDiagnosticGetErrMsgBoxNum_Stack: executable-entity=Can_EccDiagnosticGetErrMsgBoxNum, average-memory-consumption=64, maximum-memory-consumption=64, minimum-memory-consumption=64
        Can_EccDiagnosticModeEnable_Stack: executable-entity=Can_EccDiagnosticModeEnable, average-memory-consumption=72, maximum-memory-consumption=72, minimum-memory-consumption=72
        Can_EccGetErrStatus_Stack: executable-entity=Can_EccGetErrStatus, average-memory-consumption=64, maximum-memory-consumption=64, minimum-memory-consumption=64
        Can_EccClrErrStatus_Stack: executable-entity=Can_EccClrErrStatus, average-memory-consumption=56, maximum-memory-consumption=56, minimum-memory-consumption=56
        Can_DeInit_Stack: executable-entity=Can_DeInit, average-memory-consumption=104, maximum-memory-consumption=104, minimum-memory-consumption=104
