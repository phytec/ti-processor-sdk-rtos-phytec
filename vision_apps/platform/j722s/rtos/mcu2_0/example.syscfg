/**
 * @cliArgs --device "J722S_TDA4VEN_TDA4AEN_AM67" --package "AMW" --part "Default" --context "main-r5fss0-0" --product "MCU_PLUS_SDK@07.03.01"
 * @versions {"tool":"1.20.0+3562"}
 */

/**
 * Import the modules used in this configuration.
 */
const dss        = scripting.addModule("/drivers/dss/dss", {}, false);
const dss1       = dss.addInstance();

/* Not required
const gpio       = scripting.addModule("/drivers/gpio/gpio", {}, false);
const gpio1      = gpio.addInstance();
*/

const i2c        = scripting.addModule("/drivers/i2c/i2c", {}, false);
const i2c1       = i2c.addInstance();
const i2c2       = i2c.addInstance();
const debug_log  = scripting.addModule("/kernel/dpl/debug_log");
const mpu_armv7  = scripting.addModule("/kernel/dpl/mpu_armv7", {}, false);
const mpu_armv71 = mpu_armv7.addInstance();
const mpu_armv72 = mpu_armv7.addInstance();
const mpu_armv73 = mpu_armv7.addInstance();
const mpu_armv74 = mpu_armv7.addInstance();
const mpu_armv75 = mpu_armv7.addInstance();
const mpu_armv76 = mpu_armv7.addInstance();
const mpu_armv77 = mpu_armv7.addInstance();
const mpu_armv78 = mpu_armv7.addInstance();
const mpu_armv79 = mpu_armv7.addInstance();
const mpu_armv710 = mpu_armv7.addInstance();
const mpu_armv711 = mpu_armv7.addInstance();
const addr_translate  = scripting.addModule("/kernel/dpl/addr_translate", {}, false);
const addr_translate1 = addr_translate.addInstance();

/**
 * Write custom configuration values to the imported modules.
 */
dss1.$name                  = "CONFIG_DSS0";
dss1.selectOverlayManager   = "OVR2";
dss1.selectVP               = "VP2";
dss1.selectDisplayInterface = "HDMI";

/* Not required
gpio1.$name                = "CONFIG_GPIO0";
gpio1.pinDir               = "OUTPUT";
gpio1.GPIO.gpioPin.$assign = "MMC2_DAT0";
*/

i2c1.useWakeupDomainPeripherals = false;
i2c1.bitRate                    = "100KHZ";
i2c1.$name                      = "HDMI_I2C_CONFIG";
i2c1.I2C.$assign                = "I2C1";

i2c2.$name                      = "CONFIG_I2C2";
i2c2.useWakeupDomainPeripherals = false;
i2c2.I2C.$assign                = "I2C2";

debug_log.enableSharedMemLog   = false;
debug_log.enableLogZoneWarning = false;
debug_log.enableLogZoneError   = false;
debug_log.enableUartLog        = false;
debug_log.enableCssLog         = false;


mpu_armv71.baseAddr            = 0x0;
mpu_armv71.size                = 31; /* 2 GB */
mpu_armv71.attributes          = "Device";
mpu_armv71.allowExecute        = false;
mpu_armv71.$name               = "CONFIG_MPU_REGISTER";

mpu_armv72.baseAddr            = 0x0;
mpu_armv72.size                = 15; /* 32 KB */
mpu_armv72.$name               = "CONFIG_MPU_TCMA";
mpu_armv72.allowExecute        = true;
mpu_armv72.attributes          = "NonCached";

mpu_armv73.baseAddr            = 0x41010000;
mpu_armv73.size                = 15; /* 32 KB */
mpu_armv73.$name               = "CONFIG_MPU_TCMB";
mpu_armv73.allowExecute        = true;
mpu_armv73.attributes          = "NonCached";

mpu_armv74.baseAddr            = 0x60000000;
mpu_armv74.size                = 26; /* 64 MB */
mpu_armv74.$name               = "CONFIG_MPU_FLASH";
mpu_armv74.allowExecute        = true;

mpu_armv75.baseAddr            = 0x79100000;
mpu_armv75.size                = 19; /* 512 KB */
mpu_armv75.$name               = "CONFIG_MPU_MCU_MSRAM";
mpu_armv75.allowExecute        = true;

mpu_armv76.baseAddr            = 0x80000000;
mpu_armv76.size                = 31; /* 2 GB */
mpu_armv76.$name               = "CONFIG_MPU_DDR";
mpu_armv76.allowExecute        = true;

mpu_armv77.baseAddr            = 0xA2000000;
mpu_armv77.size                = 20;
mpu_armv77.$name               = "LINUX_VRING";
mpu_armv77.allowExecute        = false;
mpu_armv77.attributes          = "NonCached";

mpu_armv78.baseAddr            = 0xA2100000;
mpu_armv78.size                = 20;
mpu_armv78.allowExecute        = false;
mpu_armv78.$name               = "RESOURCE_TABLE_AND_TRACE";
mpu_armv78.attributes          = "NonCached";

mpu_armv79.baseAddr            = 0xA5000000;
mpu_armv79.size                = 24; /* 32 MB */
mpu_armv79.allowExecute        = false;
mpu_armv79.$name               = "RTOS_IPC_VRING";
mpu_armv79.attributes          = "NonCached";

mpu_armv710.baseAddr           = 0xA7000000;
mpu_armv710.size               = 24;
mpu_armv710.allowExecute       = false;
mpu_armv710.$name              = "TIOVX_RUN_TIME_LOGGING1";
mpu_armv710.attributes         = "NonCached";

mpu_armv711.baseAddr           = 0xAB000000;
mpu_armv711.size               = 24;
mpu_armv711.allowExecute       = false;
mpu_armv711.$name              = "TIOVX_RUN_TIME_LOGGING2";
mpu_armv711.attributes         = "NonCached";

dss1.DSS.$suggestSolution                   = "DSS0";
dss1.DSS.DATA0.$suggestSolution             = "VOUT0_DATA0";
dss1.DSS.DATA1.$suggestSolution             = "VOUT0_DATA1";
dss1.DSS.DATA2.$suggestSolution             = "VOUT0_DATA2";
dss1.DSS.DATA3.$suggestSolution             = "VOUT0_DATA3";
dss1.DSS.DATA4.$suggestSolution             = "VOUT0_DATA4";
dss1.DSS.DATA5.$suggestSolution             = "VOUT0_DATA5";
dss1.DSS.DATA6.$suggestSolution             = "VOUT0_DATA6";
dss1.DSS.DATA7.$suggestSolution             = "VOUT0_DATA7";
dss1.DSS.DATA8.$suggestSolution             = "VOUT0_DATA8";
dss1.DSS.DATA9.$suggestSolution             = "VOUT0_DATA9";
dss1.DSS.DATA10.$suggestSolution            = "VOUT0_DATA10";
dss1.DSS.DATA11.$suggestSolution            = "VOUT0_DATA11";
dss1.DSS.DATA12.$suggestSolution            = "VOUT0_DATA12";
dss1.DSS.DATA13.$suggestSolution            = "VOUT0_DATA13";
dss1.DSS.DATA14.$suggestSolution            = "VOUT0_DATA14";
dss1.DSS.DATA15.$suggestSolution            = "VOUT0_DATA15";
dss1.DSS.DATA16.$suggestSolution            = "GPMC0_AD8";
dss1.DSS.DATA17.$suggestSolution            = "GPMC0_AD9";
dss1.DSS.DATA18.$suggestSolution            = "GPMC0_AD10";
dss1.DSS.DATA19.$suggestSolution            = "GPMC0_AD11";
dss1.DSS.DATA20.$suggestSolution            = "GPMC0_AD12";
dss1.DSS.DATA21.$suggestSolution            = "GPMC0_AD13";
dss1.DSS.DATA22.$suggestSolution            = "GPMC0_AD14";
dss1.DSS.DATA23.$suggestSolution            = "GPMC0_AD15";
dss1.DSS.DE.$suggestSolution                = "VOUT0_DE";
dss1.DSS.EXTPCLKIN.$suggestSolution         = "GPMC0_WAIT1";
dss1.DSS.HSYNC.$suggestSolution             = "VOUT0_HSYNC";
dss1.DSS.PCLK.$suggestSolution              = "VOUT0_PCLK";
dss1.DSS.VSYNC.$suggestSolution             = "VOUT0_VSYNC";

/* Not required
gpio1.GPIO.$suggestSolution                 = "GPIO0";
*/

i2c1.I2C.SCL.$suggestSolution               = "I2C1_SCL";
i2c1.I2C.SDA.$suggestSolution               = "I2C1_SDA";
i2c2.I2C.SCL.$suggestSolution               = "GPMC0_CSn2";
i2c2.I2C.SDA.$suggestSolution               = "GPMC0_CSn3";


addr_translate1.$name      = "CONFIG_ADDR_TRANSLATE_REGION0";
addr_translate1.localAddr  = 0xC0000000;
addr_translate1.systemAddr = 0x900000000;
