/**
 * @cliArgs --device "AM62Ax" --package "AMB" --part "Default" --context "r5fss0-0" --product "MCU_PLUS_SDK@07.03.01"
 * @versions {"tool":"1.14.0+2667"}
 */

/**
 * Import the modules used in this configuration.
 */
const clock      = scripting.addModule("/kernel/dpl/clock");
const debug_log  = scripting.addModule("/kernel/dpl/debug_log");
const mpu_armv7  = scripting.addModule("/kernel/dpl/mpu_armv7", {}, false);
const mpu_armv71 = mpu_armv7.addInstance();
const mpu_armv72 = mpu_armv7.addInstance();
const mpu_armv73 = mpu_armv7.addInstance();
const mpu_armv74 = mpu_armv7.addInstance();
const mpu_armv75 = mpu_armv7.addInstance();
const mpu_armv76 = mpu_armv7.addInstance();
const mpu_armv77 = mpu_armv7.addInstance();
const mpu_armv78 = mpu_armv7.addInstance();
const mpu_armv79 = mpu_armv7.addInstance();

/**
 * Write custom configuration values to the imported modules.
 */
debug_log.enableUartLog = true;
debug_log.uartLog.$name = "CONFIG_UART0";

mpu_armv71.allowExecute = false;
mpu_armv71.$name        = "REGISTER_REGION";
mpu_armv71.tex          = 0;
mpu_armv71.isCacheable  = false;
mpu_armv71.attributes   = "CUSTOM";
mpu_armv71.isBufferable = false;

mpu_armv72.$name       = "TCMA_VEC";
mpu_armv72.size        = 15;
mpu_armv72.attributes  = "CUSTOM";
mpu_armv72.tex         = 5;
mpu_armv72.isCacheable = false;

mpu_armv73.baseAddr    = 0x80000000;
mpu_armv73.size        = 31;
mpu_armv73.$name       = "DDR";
mpu_armv73.attributes  = "CUSTOM";
mpu_armv73.tex         = 5;
mpu_armv73.isCacheable = false;

mpu_armv74.baseAddr     = 0x41010000;
mpu_armv74.size         = 15;
mpu_armv74.$name        = "TCMB";
mpu_armv74.attributes   = "CUSTOM";
mpu_armv74.isCacheable  = false;
mpu_armv74.isBufferable = false;
mpu_armv74.tex          = 4;

mpu_armv75.baseAddr    = 0x50000000;
mpu_armv75.$name       = "FSS_DAT";
mpu_armv75.size        = 27;
mpu_armv75.attributes  = "CUSTOM";
mpu_armv75.tex         = 5;
mpu_armv75.isCacheable = false;

mpu_armv76.baseAddr     = 0x9C800000;
mpu_armv76.size         = 21;
mpu_armv76.$name        = "IPC_VRING_RESOURCE_TABLE_LINUX";
mpu_armv76.attributes   = "CUSTOM";
mpu_armv76.tex          = 0;
mpu_armv76.isCacheable  = false;
mpu_armv76.isBufferable = false;
mpu_armv76.allowExecute = false;

mpu_armv77.baseAddr     = 0xA0000000;
mpu_armv77.allowExecute = false;
mpu_armv77.$name        = "IPC_RTOS_VRING_TIOVX";
mpu_armv77.attributes   = "CUSTOM";
mpu_armv77.isCacheable  = false;
mpu_armv77.isBufferable = false;
mpu_armv77.tex          = 0;
mpu_armv77.size         = 24;

mpu_armv78.$name        = "TIOVX_RUN_TIME_LOGGING1";
mpu_armv78.allowExecute = false;
mpu_armv78.attributes   = "CUSTOM";
mpu_armv78.isCacheable  = false;
mpu_armv78.isBufferable = false;
mpu_armv78.tex          = 0;
mpu_armv78.baseAddr     = 0xA1000000;
mpu_armv78.size         = 24;

mpu_armv79.$name        = "TIOVX_RUN_TIME_LOGGING2";
mpu_armv79.allowExecute = false;
mpu_armv79.attributes   = "CUSTOM";
mpu_armv79.isCacheable  = false;
mpu_armv79.isBufferable = false;
mpu_armv79.tex          = 0;
mpu_armv79.baseAddr     = 0xA2000000;
mpu_armv79.size         = 24;

/**
 * Pinmux solution for unlocked pins/peripherals. This ensures that minor changes to the automatic solver in a future
 * version of the tool will not impact the pinmux you originally saw.  These lines can be completely deleted in order to
 * re-solve from scratch.
 */
debug_log.uartLog.WKUP_UART.$suggestSolution     = "WKUP_USART0";
debug_log.uartLog.WKUP_UART.RXD.$suggestSolution = "ball.C9";
debug_log.uartLog.WKUP_UART.TXD.$suggestSolution = "ball.E9";
