/**
 * @cliArgs --device "J721S2_TDA4VE_TDA4AL_TDA4VL_AM68x" --part "Default" --package "ALZ"
 * @versions {"tool":"1.21.0+3721"}
 */

/**
 * These are the peripherals and settings in this configuration
 */
const iAUXPHY1                      = scripting.addPeripheral("AUXPHY");
iAUXPHY1.$name                      = "MyAUXPHY0";
iAUXPHY1.AUXN.$assign               = "DP0_AUXN";
iAUXPHY1.AUXP.$assign               = "DP0_AUXP";
const iCPSW2G1                      = scripting.addPeripheral("CPSW2G");
iCPSW2G1.$name                      = "MyCPSW2G0";
iCPSW2G1.$assign                    = "CPSW2G_0";
iCPSW2G1.CLKOUT.$used               = false;
iCPSW2G1.CRS_DV.$used               = false;
iCPSW2G1.MDC.$assign                = "MCASP1_AXR0";
iCPSW2G1.MDIO.$assign               = "MCASP1_AFSX";
iCPSW2G1.RD0.$assign                = "MCASP1_ACLKX";
iCPSW2G1.RD1.$assign                = "MCASP0_AXR12";
iCPSW2G1.RD2.$assign                = "MCASP0_AXR13";
iCPSW2G1.RD3.$assign                = "MCASP0_AXR14";
iCPSW2G1.RMII_REF_CLK.$used         = false;
iCPSW2G1.RXC.$assign                = "MCASP1_AXR3";
iCPSW2G1.RXD0.$used                 = false;
iCPSW2G1.RXD1.$used                 = false;
iCPSW2G1.RX_CTL.$assign             = "MCASP0_AXR15";
iCPSW2G1.RX_ER.$used                = false;
iCPSW2G1.TD0.$assign                = "MCASP0_AXR7";
iCPSW2G1.TD1.$assign                = "MCASP0_AXR8";
iCPSW2G1.TD2.$assign                = "MCASP0_AXR9";
iCPSW2G1.TD3.$assign                = "MCASP0_AXR10";
iCPSW2G1.TXC.$assign                = "MCASP1_AXR4";
iCPSW2G1.TXD0.$used                 = false;
iCPSW2G1.TXD1.$used                 = false;
iCPSW2G1.TX_CTL.$assign             = "MCASP0_AXR11";
iCPSW2G1.TX_EN.$used                = false;
const iCSI1                         = scripting.addPeripheral("CSI");
iCSI1.$name                         = "MyCSIRX0";
iCSI1.RXCLKN.$assign                = "CSI0_RXCLKN";
iCSI1.RXCLKP.$assign                = "CSI0_RXCLKP";
iCSI1.RXN0.$assign                  = "CSI0_RXN0";
iCSI1.RXN1.$assign                  = "CSI0_RXN1";
iCSI1.RXN2.$assign                  = "CSI0_RXN2";
iCSI1.RXN3.$assign                  = "CSI0_RXN3";
iCSI1.RXP0.$assign                  = "CSI0_RXP0";
iCSI1.RXP1.$assign                  = "CSI0_RXP1";
iCSI1.RXP2.$assign                  = "CSI0_RXP2";
iCSI1.RXP3.$assign                  = "CSI0_RXP3";
iCSI1.RXRCALIB.$assign              = "CSI0_RXRCALIB";
iCSI1.TXCLKN.$used                  = false;
iCSI1.TXCLKP.$used                  = false;
iCSI1.TXN0.$used                    = false;
iCSI1.TXN1.$used                    = false;
iCSI1.TXN2.$used                    = false;
iCSI1.TXN3.$used                    = false;
iCSI1.TXP0.$used                    = false;
iCSI1.TXP1.$used                    = false;
iCSI1.TXP2.$used                    = false;
iCSI1.TXP3.$used                    = false;
const iCSI2                         = scripting.addPeripheral("CSI");
iCSI2.$name                         = "MyCSIRX1";
iCSI2.RXCLKN.$assign                = "CSI1_RXCLKN";
iCSI2.RXCLKP.$assign                = "CSI1_RXCLKP";
iCSI2.RXN0.$assign                  = "CSI1_RXN0";
iCSI2.RXN1.$assign                  = "CSI1_RXN1";
iCSI2.RXN2.$assign                  = "CSI1_RXN2";
iCSI2.RXN3.$assign                  = "CSI1_RXN3";
iCSI2.RXP0.$assign                  = "CSI1_RXP0";
iCSI2.RXP1.$assign                  = "CSI1_RXP1";
iCSI2.RXP2.$assign                  = "CSI1_RXP2";
iCSI2.RXP3.$assign                  = "CSI1_RXP3";
iCSI2.RXRCALIB.$assign              = "CSI1_RXRCALIB";
iCSI2.TXCLKN.$used                  = false;
iCSI2.TXCLKP.$used                  = false;
iCSI2.TXN0.$used                    = false;
iCSI2.TXN1.$used                    = false;
iCSI2.TXN2.$used                    = false;
iCSI2.TXN3.$used                    = false;
iCSI2.TXP0.$used                    = false;
iCSI2.TXP1.$used                    = false;
iCSI2.TXP2.$used                    = false;
iCSI2.TXP3.$used                    = false;
const iDDRSS1                       = scripting.addPeripheral("DDRSS");
iDDRSS1.$name                       = "MyDDRSS0";
iDDRSS1.$assign                     = "DDR_0";
iDDRSS1.CA0.$assign                 = "DDR0_CA0";
iDDRSS1.CA1.$assign                 = "DDR0_CA1";
iDDRSS1.CA2.$assign                 = "DDR0_CA2";
iDDRSS1.CA3.$assign                 = "DDR0_CA3";
iDDRSS1.CA4.$assign                 = "DDR0_CA4";
iDDRSS1.CA5.$assign                 = "DDR0_CA5";
iDDRSS1.CAL0.$assign                = "DDR0_CAL0";
iDDRSS1.CKE0.$assign                = "DDR0_CKE0";
iDDRSS1.CKE1.$assign                = "DDR0_CKE1";
iDDRSS1.CKN.$assign                 = "DDR0_CKN";
iDDRSS1.CKP.$assign                 = "DDR0_CKP";
iDDRSS1.CSn0_0.$assign              = "DDR0_CSn0_0";
iDDRSS1.CSn0_1.$assign              = "DDR0_CSn0_1";
iDDRSS1.CSn1_0.$assign              = "DDR0_CSn1_0";
iDDRSS1.CSn1_1.$assign              = "DDR0_CSn1_1";
iDDRSS1.DM0.$assign                 = "DDR0_DM0";
iDDRSS1.DM1.$assign                 = "DDR0_DM1";
iDDRSS1.DM2.$assign                 = "DDR0_DM2";
iDDRSS1.DM3.$assign                 = "DDR0_DM3";
iDDRSS1.DQ0.$assign                 = "DDR0_DQ0";
iDDRSS1.DQ1.$assign                 = "DDR0_DQ1";
iDDRSS1.DQ10.$assign                = "DDR0_DQ10";
iDDRSS1.DQ11.$assign                = "DDR0_DQ11";
iDDRSS1.DQ12.$assign                = "DDR0_DQ12";
iDDRSS1.DQ13.$assign                = "DDR0_DQ13";
iDDRSS1.DQ14.$assign                = "DDR0_DQ14";
iDDRSS1.DQ15.$assign                = "DDR0_DQ15";
iDDRSS1.DQ16.$assign                = "DDR0_DQ16";
iDDRSS1.DQ17.$assign                = "DDR0_DQ17";
iDDRSS1.DQ18.$assign                = "DDR0_DQ18";
iDDRSS1.DQ19.$assign                = "DDR0_DQ19";
iDDRSS1.DQ2.$assign                 = "DDR0_DQ2";
iDDRSS1.DQ20.$assign                = "DDR0_DQ20";
iDDRSS1.DQ21.$assign                = "DDR0_DQ21";
iDDRSS1.DQ22.$assign                = "DDR0_DQ22";
iDDRSS1.DQ23.$assign                = "DDR0_DQ23";
iDDRSS1.DQ24.$assign                = "DDR0_DQ24";
iDDRSS1.DQ25.$assign                = "DDR0_DQ25";
iDDRSS1.DQ26.$assign                = "DDR0_DQ26";
iDDRSS1.DQ27.$assign                = "DDR0_DQ27";
iDDRSS1.DQ28.$assign                = "DDR0_DQ28";
iDDRSS1.DQ29.$assign                = "DDR0_DQ29";
iDDRSS1.DQ3.$assign                 = "DDR0_DQ3";
iDDRSS1.DQ30.$assign                = "DDR0_DQ30";
iDDRSS1.DQ31.$assign                = "DDR0_DQ31";
iDDRSS1.DQ4.$assign                 = "DDR0_DQ4";
iDDRSS1.DQ5.$assign                 = "DDR0_DQ5";
iDDRSS1.DQ6.$assign                 = "DDR0_DQ6";
iDDRSS1.DQ7.$assign                 = "DDR0_DQ7";
iDDRSS1.DQ8.$assign                 = "DDR0_DQ8";
iDDRSS1.DQ9.$assign                 = "DDR0_DQ9";
iDDRSS1.DQS0N.$assign               = "DDR0_DQS0N";
iDDRSS1.DQS0P.$assign               = "DDR0_DQS0P";
iDDRSS1.DQS1N.$assign               = "DDR0_DQS1N";
iDDRSS1.DQS1P.$assign               = "DDR0_DQS1P";
iDDRSS1.DQS2N.$assign               = "DDR0_DQS2N";
iDDRSS1.DQS2P.$assign               = "DDR0_DQS2P";
iDDRSS1.DQS3N.$assign               = "DDR0_DQS3N";
iDDRSS1.DQS3P.$assign               = "DDR0_DQS3P";
iDDRSS1.RESETn.$assign              = "DDR0_RESETn";
iDDRSS1.RET.$assign                 = "DDR0_RET";
const iDDRSS2                       = scripting.addPeripheral("DDRSS");
iDDRSS2.$name                       = "MyDDRSS1";
iDDRSS2.$assign                     = "DDR_1";
iDDRSS2.CA0.$assign                 = "DDR1_CA0";
iDDRSS2.CA1.$assign                 = "DDR1_CA1";
iDDRSS2.CA2.$assign                 = "DDR1_CA2";
iDDRSS2.CA3.$assign                 = "DDR1_CA3";
iDDRSS2.CA4.$assign                 = "DDR1_CA4";
iDDRSS2.CA5.$assign                 = "DDR1_CA5";
iDDRSS2.CAL0.$assign                = "DDR1_CAL0";
iDDRSS2.CKE0.$assign                = "DDR1_CKE0";
iDDRSS2.CKE1.$assign                = "DDR1_CKE1";
iDDRSS2.CKN.$assign                 = "DDR1_CKN";
iDDRSS2.CKP.$assign                 = "DDR1_CKP";
iDDRSS2.CSn0_0.$assign              = "DDR1_CSn0_0";
iDDRSS2.CSn0_1.$assign              = "DDR1_CSn0_1";
iDDRSS2.CSn1_0.$assign              = "DDR1_CSn1_0";
iDDRSS2.CSn1_1.$assign              = "DDR1_CSn1_1";
iDDRSS2.DM0.$assign                 = "DDR1_DM0";
iDDRSS2.DM1.$assign                 = "DDR1_DM1";
iDDRSS2.DM2.$assign                 = "DDR1_DM2";
iDDRSS2.DM3.$assign                 = "DDR1_DM3";
iDDRSS2.DQ0.$assign                 = "DDR1_DQ0";
iDDRSS2.DQ1.$assign                 = "DDR1_DQ1";
iDDRSS2.DQ10.$assign                = "DDR1_DQ10";
iDDRSS2.DQ11.$assign                = "DDR1_DQ11";
iDDRSS2.DQ12.$assign                = "DDR1_DQ12";
iDDRSS2.DQ13.$assign                = "DDR1_DQ13";
iDDRSS2.DQ14.$assign                = "DDR1_DQ14";
iDDRSS2.DQ15.$assign                = "DDR1_DQ15";
iDDRSS2.DQ16.$assign                = "DDR1_DQ16";
iDDRSS2.DQ17.$assign                = "DDR1_DQ17";
iDDRSS2.DQ18.$assign                = "DDR1_DQ18";
iDDRSS2.DQ19.$assign                = "DDR1_DQ19";
iDDRSS2.DQ2.$assign                 = "DDR1_DQ2";
iDDRSS2.DQ20.$assign                = "DDR1_DQ20";
iDDRSS2.DQ21.$assign                = "DDR1_DQ21";
iDDRSS2.DQ22.$assign                = "DDR1_DQ22";
iDDRSS2.DQ23.$assign                = "DDR1_DQ23";
iDDRSS2.DQ24.$assign                = "DDR1_DQ24";
iDDRSS2.DQ25.$assign                = "DDR1_DQ25";
iDDRSS2.DQ26.$assign                = "DDR1_DQ26";
iDDRSS2.DQ27.$assign                = "DDR1_DQ27";
iDDRSS2.DQ28.$assign                = "DDR1_DQ28";
iDDRSS2.DQ29.$assign                = "DDR1_DQ29";
iDDRSS2.DQ3.$assign                 = "DDR1_DQ3";
iDDRSS2.DQ30.$assign                = "DDR1_DQ30";
iDDRSS2.DQ31.$assign                = "DDR1_DQ31";
iDDRSS2.DQ4.$assign                 = "DDR1_DQ4";
iDDRSS2.DQ5.$assign                 = "DDR1_DQ5";
iDDRSS2.DQ6.$assign                 = "DDR1_DQ6";
iDDRSS2.DQ7.$assign                 = "DDR1_DQ7";
iDDRSS2.DQ8.$assign                 = "DDR1_DQ8";
iDDRSS2.DQ9.$assign                 = "DDR1_DQ9";
iDDRSS2.DQS0N.$assign               = "DDR1_DQS0N";
iDDRSS2.DQS0P.$assign               = "DDR1_DQS0P";
iDDRSS2.DQS1N.$assign               = "DDR1_DQS1N";
iDDRSS2.DQS1P.$assign               = "DDR1_DQS1P";
iDDRSS2.DQS2N.$assign               = "DDR1_DQS2N";
iDDRSS2.DQS2P.$assign               = "DDR1_DQS2P";
iDDRSS2.DQS3N.$assign               = "DDR1_DQS3N";
iDDRSS2.DQS3P.$assign               = "DDR1_DQS3P";
iDDRSS2.RESETn.$assign              = "DDR1_RESETn";
iDDRSS2.RET.$assign                 = "DDR1_RET";
const iDP1                          = scripting.addPeripheral("DP");
iDP1.$name                          = "MyDP0";
iDP1.HPD.$used                      = false;
iDP1.TXN0.$assign                   = "SERDES0_TX2_N";
iDP1.TXN1.$assign                   = "SERDES0_TX3_N";
iDP1.TXN2.$used                     = false;
iDP1.TXN3.$used                     = false;
iDP1.TXP0.$assign                   = "SERDES0_TX2_P";
iDP1.TXP1.$assign                   = "SERDES0_TX3_P";
iDP1.TXP2.$used                     = false;
iDP1.TXP3.$used                     = false;
const iDSI1                         = scripting.addPeripheral("DSI");
iDSI1.$name                         = "MyDSI0";
iDSI1.$assign                       = "DSI_TX_0";
iDSI1.TXCLKN.$assign                = "DSI0_TXCLKN";
iDSI1.TXCLKP.$assign                = "DSI0_TXCLKP";
iDSI1.TXN0.$assign                  = "DSI0_TXN0";
iDSI1.TXN1.$assign                  = "DSI0_TXN1";
iDSI1.TXN2.$assign                  = "DSI0_TXN2";
iDSI1.TXN3.$assign                  = "DSI0_TXN3";
iDSI1.TXP0.$assign                  = "DSI0_TXP0";
iDSI1.TXP1.$assign                  = "DSI0_TXP1";
iDSI1.TXP2.$assign                  = "DSI0_TXP2";
iDSI1.TXP3.$assign                  = "DSI0_TXP3";
iDSI1.TXRCALIB.$assign              = "DSI0_TXRCALIB";
const iGPIO1                        = scripting.addPeripheral("GPIO");
iGPIO1["0"].$used                   = false;
iGPIO1["1"].$used                   = false;
iGPIO1["2"].$used                   = false;
iGPIO1["3"].$assign                 = "MCAN13_TX";
iGPIO1["4"].$used                   = false;
iGPIO1["5"].$used                   = false;
iGPIO1["6"].$used                   = false;
iGPIO1["7"].$used                   = false;
iGPIO1["8"].$assign                 = "MCAN15_RX";
iGPIO1["9"].$used                   = false;
iGPIO1["10"].$used                  = false;
iGPIO1["11"].$assign                = "GPIO0_11";
iGPIO1["12"].$used                  = false;
iGPIO1["13"].$assign                = "PMIC_WAKE0n";
iGPIO1["14"].$used                  = false;
iGPIO1["15"].$used                  = false;
iGPIO1["16"].$used                  = false;
iGPIO1["17"].$used                  = false;
iGPIO1["18"].$assign                = "MCASP0_AXR2";
iGPIO1["19"].$used                  = false;
iGPIO1["20"].$used                  = false;
iGPIO1["21"].$used                  = false;
iGPIO1["22"].$used                  = false;
iGPIO1["23"].$assign                = "MCASP2_AXR0";
iGPIO1["24"].$used                  = false;
iGPIO1["25"].$used                  = false;
iGPIO1["26"].$assign                = "MCAN0_RX";
iGPIO1["27"].$used                  = false;
iGPIO1["28"].$assign                = "MCAN1_RX";
iGPIO1["29"].$used                  = false;
iGPIO1["30"].$used                  = false;
iGPIO1["31"].$used                  = false;
iGPIO1["32"].$used                  = false;
iGPIO1["33"].$used                  = false;
iGPIO1["34"].$used                  = false;
iGPIO1["35"].$used                  = false;
iGPIO1["36"].$used                  = false;
iGPIO1["37"].$used                  = false;
iGPIO1["38"].$used                  = false;
iGPIO1["39"].$used                  = false;
iGPIO1["40"].$used                  = false;
iGPIO1["41"].$used                  = false;
iGPIO1["42"].$used                  = false;
iGPIO1["43"].$used                  = false;
iGPIO1["44"].$used                  = false;
iGPIO1["45"].$used                  = false;
iGPIO1["46"].$used                  = false;
iGPIO1["47"].$used                  = false;
iGPIO1["48"].$used                  = false;
iGPIO1["49"].$used                  = false;
iGPIO1["50"].$used                  = false;
iGPIO1["51"].$assign                = "SPI0_CS0";
iGPIO1["52"].$used                  = false;
iGPIO1["53"].$used                  = false;
iGPIO1["54"].$used                  = false;
iGPIO1["55"].$used                  = false;
iGPIO1["56"].$used                  = false;
iGPIO1["57"].$used                  = false;
iGPIO1["58"].$used                  = false;
iGPIO1["59"].$used                  = false;
iGPIO1["60"].$used                  = false;
iGPIO1["61"].$used                  = false;
iGPIO1["62"].$used                  = false;
iGPIO1["63"].$used                  = false;
iGPIO1["64"].$used                  = false;
iGPIO1["65"].$used                  = false;
iGPIO1.$name                        = "MyGPIO0";
iGPIO1.$assign                      = "GPIO_0";
const iI2C1                         = scripting.addPeripheral("I2C");
iI2C1.$name                         = "MyI2C0";
iI2C1.$assign                       = "I2C_0";
iI2C1.SCL.$assign                   = "I2C0_SCL";
iI2C1.SDA.$assign                   = "I2C0_SDA";
const iI2C2                         = scripting.addPeripheral("I2C");
iI2C2.$name                         = "MyI2C1";
iI2C2.$assign                       = "I2C_1";
iI2C2.SCL.$assign                   = "ECAP0_IN_APWM_OUT";
iI2C2.SDA.$assign                   = "EXT_REFCLK1";
const iI2C3                         = scripting.addPeripheral("I2C");
iI2C3.$name                         = "MyI2C3";
iI2C3.$assign                       = "I2C_3";
iI2C3.SCL.$assign                   = "MCAN0_TX";
iI2C3.SDA.$assign                   = "MCASP2_AXR1";
const iI2C4                         = scripting.addPeripheral("I2C");
iI2C4.$name                         = "MyI2C4";
iI2C4.$assign                       = "I2C_4";
iI2C4.SCL.$assign                   = "MCAN14_TX";
iI2C4.SDA.$assign                   = "MCAN13_RX";
const iI2C5                         = scripting.addPeripheral("I2C");
iI2C5.$name                         = "MyI2C5";
iI2C5.$assign                       = "I2C_5";
iI2C5.SCL.$assign                   = "MCAN15_TX";
iI2C5.SDA.$assign                   = "MCAN14_RX";
const iMCAN1                        = scripting.addPeripheral("MCAN");
iMCAN1.$name                        = "MyMCAN16";
iMCAN1.$assign                      = "MCAN_16";
iMCAN1.RX.$assign                   = "MCAN16_RX";
iMCAN1.TX.$assign                   = "MCAN16_TX";
const iMCU_ADC1                     = scripting.addPeripheral("MCU_ADC");
iMCU_ADC1.$name                     = "MyMCU_ADC0";
iMCU_ADC1.$assign                   = "MCU_ADC_0";
iMCU_ADC1.AIN0.$assign              = "MCU_ADC0_AIN0";
iMCU_ADC1.AIN1.$assign              = "MCU_ADC0_AIN1";
iMCU_ADC1.AIN2.$assign              = "MCU_ADC0_AIN2";
iMCU_ADC1.AIN3.$assign              = "MCU_ADC0_AIN3";
iMCU_ADC1.AIN4.$assign              = "MCU_ADC0_AIN4";
iMCU_ADC1.AIN5.$assign              = "MCU_ADC0_AIN5";
iMCU_ADC1.AIN6.$assign              = "MCU_ADC0_AIN6";
iMCU_ADC1.AIN7.$assign              = "MCU_ADC0_AIN7";
const iMCU_ADC2                     = scripting.addPeripheral("MCU_ADC");
iMCU_ADC2.$name                     = "MyMCU_ADC1";
iMCU_ADC2.AIN0.$assign              = "MCU_ADC1_AIN0";
iMCU_ADC2.AIN1.$assign              = "MCU_ADC1_AIN1";
iMCU_ADC2.AIN2.$assign              = "MCU_ADC1_AIN2";
iMCU_ADC2.AIN3.$assign              = "MCU_ADC1_AIN3";
iMCU_ADC2.AIN4.$assign              = "MCU_ADC1_AIN4";
iMCU_ADC2.AIN5.$assign              = "MCU_ADC1_AIN5";
iMCU_ADC2.AIN6.$assign              = "MCU_ADC1_AIN6";
iMCU_ADC2.AIN7.$assign              = "MCU_ADC1_AIN7";
const iMCU_CPSW2G1                  = scripting.addPeripheral("MCU_CPSW2G");
iMCU_CPSW2G1.$name                  = "MyMCU_CPSW2G0";
iMCU_CPSW2G1.$assign                = "MCU_CPSW2G_0";
iMCU_CPSW2G1.CRS_DV.$used           = false;
iMCU_CPSW2G1.RD0.$assign            = "MCU_RGMII1_RD0";
iMCU_CPSW2G1.RD1.$assign            = "MCU_RGMII1_RD1";
iMCU_CPSW2G1.RD2.$assign            = "MCU_RGMII1_RD2";
iMCU_CPSW2G1.RD3.$assign            = "MCU_RGMII1_RD3";
iMCU_CPSW2G1.REF_CLK.$used          = false;
iMCU_CPSW2G1.RXC.$assign            = "MCU_RGMII1_RXC";
iMCU_CPSW2G1.RXD0.$used             = false;
iMCU_CPSW2G1.RXD1.$used             = false;
iMCU_CPSW2G1.RX_CTL.$assign         = "MCU_RGMII1_RX_CTL";
iMCU_CPSW2G1.RX_ER.$used            = false;
iMCU_CPSW2G1.TD0.$assign            = "MCU_RGMII1_TD0";
iMCU_CPSW2G1.TD1.$assign            = "MCU_RGMII1_TD1";
iMCU_CPSW2G1.TD2.$assign            = "MCU_RGMII1_TD2";
iMCU_CPSW2G1.TD3.$assign            = "MCU_RGMII1_TD3";
iMCU_CPSW2G1.TXC.$assign            = "MCU_RGMII1_TXC";
iMCU_CPSW2G1.TXD0.$used             = false;
iMCU_CPSW2G1.TXD1.$used             = false;
iMCU_CPSW2G1.TX_CTL.$assign         = "MCU_RGMII1_TX_CTL";
iMCU_CPSW2G1.TX_EN.$used            = false;
const iMCU_I2C1                     = scripting.addPeripheral("MCU_I2C");
iMCU_I2C1.$name                     = "MyMCU_I2C0";
iMCU_I2C1.$assign                   = "MCU_I2C_0";
iMCU_I2C1.SCL.$assign               = "MCU_I2C0_SCL";
iMCU_I2C1.SDA.$assign               = "MCU_I2C0_SDA";
const iMCU_I3C1                     = scripting.addPeripheral("MCU_I3C");
iMCU_I3C1.$name                     = "MyMCU_I3C1";
iMCU_I3C1.$assign                   = "MCU_I3C_0";
iMCU_I3C1.SCL.$assign               = "WKUP_GPIO0_8";
iMCU_I3C1.SDA.$assign               = "WKUP_GPIO0_9";
iMCU_I3C1.SDAPULLEN.$assign         = "WKUP_GPIO0_11";
const iMCU_MCAN1                    = scripting.addPeripheral("MCU_MCAN");
iMCU_MCAN1.$name                    = "MyMCU_MCAN0";
iMCU_MCAN1.$assign                  = "MCU_MCAN_0";
iMCU_MCAN1.RX.$assign               = "MCU_MCAN0_RX";
iMCU_MCAN1.TX.$assign               = "MCU_MCAN0_TX";
const iMCU_MCAN2                    = scripting.addPeripheral("MCU_MCAN");
iMCU_MCAN2.$name                    = "MyMCU_MCAN1";
iMCU_MCAN2.$assign                  = "MCU_MCAN_1";
iMCU_MCAN2.RX.$assign               = "WKUP_GPIO0_5";
iMCU_MCAN2.TX.$assign               = "WKUP_GPIO0_4";
const iMCU_MDIO1                    = scripting.addPeripheral("MCU_MDIO");
iMCU_MDIO1.$name                    = "MyMCU_MDIO0";
iMCU_MDIO1.$assign                  = "MCU_MDIO_0";
iMCU_MDIO1.MDC.$assign              = "MCU_MDIO0_MDC";
iMCU_MDIO1.MDIO.$assign             = "MCU_MDIO0_MDIO";
const iMCU_OSPI1                    = scripting.addPeripheral("MCU_OSPI");
iMCU_OSPI1.$name                    = "MyMCU_OSPI0";
iMCU_OSPI1.CLK.$assign              = "MCU_OSPI0_CLK";
iMCU_OSPI1.CSn0.$assign             = "MCU_OSPI0_CSn0";
iMCU_OSPI1.CSn1.$used               = false;
iMCU_OSPI1.CSn2.$used               = false;
iMCU_OSPI1.CSn3.$used               = false;
iMCU_OSPI1.D0.$assign               = "MCU_OSPI0_D0";
iMCU_OSPI1.D1.$assign               = "MCU_OSPI0_D1";
iMCU_OSPI1.D2.$assign               = "MCU_OSPI0_D2";
iMCU_OSPI1.D3.$assign               = "MCU_OSPI0_D3";
iMCU_OSPI1.D4.$assign               = "MCU_OSPI0_D4";
iMCU_OSPI1.D5.$assign               = "MCU_OSPI0_D5";
iMCU_OSPI1.D6.$assign               = "MCU_OSPI0_D6";
iMCU_OSPI1.D7.$assign               = "MCU_OSPI0_D7";
iMCU_OSPI1.DQS.$assign              = "MCU_OSPI0_DQS";
iMCU_OSPI1.ECC_FAIL.$assign         = "MCU_OSPI0_CSn3";
iMCU_OSPI1.LBCLKO.$used             = false;
iMCU_OSPI1.RESET_OUT0.$assign       = "MCU_OSPI0_CSn2";
iMCU_OSPI1.RESET_OUT1.$used         = false;
const iMCU_OSPI2                    = scripting.addPeripheral("MCU_OSPI");
iMCU_OSPI2.$name                    = "MyMCU_OSPI1";
iMCU_OSPI2.CLK.$assign              = "MCU_OSPI1_CLK";
iMCU_OSPI2.CSn0.$assign             = "MCU_OSPI1_CSn0";
iMCU_OSPI2.CSn1.$used               = false;
iMCU_OSPI2.CSn2.$used               = false;
iMCU_OSPI2.CSn3.$used               = false;
iMCU_OSPI2.D0.$assign               = "MCU_OSPI1_D0";
iMCU_OSPI2.D1.$assign               = "MCU_OSPI1_D1";
iMCU_OSPI2.D2.$assign               = "MCU_OSPI1_D2";
iMCU_OSPI2.D3.$assign               = "MCU_OSPI1_D3";
iMCU_OSPI2.D4.$used                 = false;
iMCU_OSPI2.D5.$used                 = false;
iMCU_OSPI2.D6.$used                 = false;
iMCU_OSPI2.D7.$used                 = false;
iMCU_OSPI2.DQS.$assign              = "MCU_OSPI1_DQS";
iMCU_OSPI2.ECC_FAIL.$used           = false;
iMCU_OSPI2.LBCLKO.$assign           = "MCU_OSPI1_LBCLKO";
iMCU_OSPI2.RESET_OUT0.$used         = false;
iMCU_OSPI2.RESET_OUT1.$used         = false;
const iMCU_UART1                    = scripting.addPeripheral("MCU_UART");
iMCU_UART1.$name                    = "MyMCU_UART0";
iMCU_UART1.$assign                  = "MCU_USART_0";
iMCU_UART1.CTSn.$assign             = "WKUP_GPIO0_14";
iMCU_UART1.RTSn.$assign             = "WKUP_GPIO0_15";
iMCU_UART1.RXD.$assign              = "WKUP_GPIO0_13";
iMCU_UART1.TXD.$assign              = "WKUP_GPIO0_12";
const iMMCSD1                       = scripting.addPeripheral("MMCSD");
iMMCSD1.$name                       = "MyMMCSD0";
iMMCSD1.$assign                     = "MMC_0";
iMMCSD1.CALPAD.$assign              = "MMC0_CALPAD";
iMMCSD1.CLK.$assign                 = "MMC0_CLK";
iMMCSD1.CMD.$assign                 = "MMC0_CMD";
iMMCSD1.DAT0.$assign                = "MMC0_DAT0";
iMMCSD1.DAT1.$assign                = "MMC0_DAT1";
iMMCSD1.DAT2.$assign                = "MMC0_DAT2";
iMMCSD1.DAT3.$assign                = "MMC0_DAT3";
iMMCSD1.DAT4.$assign                = "MMC0_DAT4";
iMMCSD1.DAT5.$assign                = "MMC0_DAT5";
iMMCSD1.DAT6.$assign                = "MMC0_DAT6";
iMMCSD1.DAT7.$assign                = "MMC0_DAT7";
iMMCSD1.DS.$assign                  = "MMC0_DS";
iMMCSD1.SDCD.$used                  = false;
iMMCSD1.SDWP.$used                  = false;
const iMMCSD2                       = scripting.addPeripheral("MMCSD");
iMMCSD2.$name                       = "MyMMCSD1";
iMMCSD2.$assign                     = "MMC_1";
iMMCSD2.CALPAD.$used                = false;
iMMCSD2.CLK.$assign                 = "MMC1_CLK";
iMMCSD2.CMD.$assign                 = "MMC1_CMD";
iMMCSD2.DAT0.$assign                = "MMC1_DAT0";
iMMCSD2.DAT1.$assign                = "MMC1_DAT1";
iMMCSD2.DAT2.$assign                = "MMC1_DAT2";
iMMCSD2.DAT3.$assign                = "MMC1_DAT3";
iMMCSD2.DAT4.$used                  = false;
iMMCSD2.DAT5.$used                  = false;
iMMCSD2.DAT6.$used                  = false;
iMMCSD2.DAT7.$used                  = false;
iMMCSD2.DS.$used                    = false;
iMMCSD2.SDCD.$assign                = "TIMER_IO0";
iMMCSD2.SDWP.$used                  = false;
const iOSC1                         = scripting.addPeripheral("OSC");
iOSC1.$name                         = "MyOSC1";
iOSC1.$assign                       = "OSC_1";
iOSC1.XI.$assign                    = "OSC1_XI";
iOSC1.XO.$assign                    = "OSC1_XO";
const iPCIE1                        = scripting.addPeripheral("PCIE");
iPCIE1.$name                        = "MyPCIE1";
iPCIE1.REFCLKN.$used                = false;
iPCIE1.REFCLKP.$used                = false;
iPCIE1.CLKREQn.$used                = false;
iPCIE1.RXN0.$assign                 = "SERDES0_RX0_N";
iPCIE1.RXN1.$used                   = false;
iPCIE1.RXN2.$used                   = false;
iPCIE1.RXN3.$used                   = false;
iPCIE1.RXP0.$assign                 = "SERDES0_RX0_P";
iPCIE1.RXP1.$used                   = false;
iPCIE1.RXP2.$used                   = false;
iPCIE1.RXP3.$used                   = false;
iPCIE1.TXN0.$assign                 = "SERDES0_TX0_N";
iPCIE1.TXN1.$used                   = false;
iPCIE1.TXN2.$used                   = false;
iPCIE1.TXN3.$used                   = false;
iPCIE1.TXP0.$assign                 = "SERDES0_TX0_P";
iPCIE1.TXP1.$used                   = false;
iPCIE1.TXP2.$used                   = false;
iPCIE1.TXP3.$used                   = false;
const iSERDES1                      = scripting.addPeripheral("SERDES");
iSERDES1.$name                      = "MySERDES0";
iSERDES1.REFCLK_N.$assign           = "SERDES0_REFCLK_N";
iSERDES1.REFCLK_P.$assign           = "SERDES0_REFCLK_P";
iSERDES1.REXT.$assign               = "SERDES0_REXT";
const iSYSTEM1                      = scripting.addPeripheral("SYSTEM");
iSYSTEM1.$name                      = "MySYSTEM0";
iSYSTEM1.$assign                    = "SYSTEM_0";
iSYSTEM1.MCU_ADC_EXT_TRIGGER0.$used = false;
iSYSTEM1.MCU_ADC_EXT_TRIGGER1.$used = false;
iSYSTEM1.AUDIO_EXT_REFCLK0.$used    = false;
iSYSTEM1.AUDIO_EXT_REFCLK1.$used    = false;
iSYSTEM1.EXTINTn.$assign            = "EXTINTn";
iSYSTEM1.EXT_REFCLK1.$used          = false;
iSYSTEM1.FCLK_MUX.$used             = false;
iSYSTEM1.OBSCLK0.$used              = false;
iSYSTEM1.OBSCLK1.$used              = false;
iSYSTEM1.RESETSTATz.$assign         = "RESETSTATz";
iSYSTEM1.SOC_SAFETY_ERRORn.$assign  = "SOC_SAFETY_ERRORn";
iSYSTEM1.SYSCLKOUT0.$used           = false;
const iUART1                        = scripting.addPeripheral("UART");
iUART1.$name                        = "MyUART8";
iUART1.$assign                      = "USART_8";
iUART1.CTSn.$assign                 = "MCASP0_AXR0";
iUART1.DCDn.$used                   = false;
iUART1.DSRn.$used                   = false;
iUART1.DTRn.$used                   = false;
iUART1.RIn.$used                    = false;
iUART1.RTSn.$assign                 = "MCASP0_AXR1";
iUART1.RXD.$assign                  = "SPI0_CS1";
iUART1.TXD.$assign                  = "SPI0_CLK";
const iUART2                        = scripting.addPeripheral("UART");
iUART2.$name                        = "MyUART2";
iUART2.$assign                      = "USART_2";
iUART2.CTSn.$used                   = false;
iUART2.DCDn.$used                   = false;
iUART2.DSRn.$used                   = false;
iUART2.DTRn.$used                   = false;
iUART2.RIn.$used                    = false;
iUART2.RTSn.$used                   = false;
iUART2.RXD.$assign                  = "SPI0_D0";
iUART2.TXD.$assign                  = "SPI0_D1";
const iUART3                        = scripting.addPeripheral("UART");
iUART3.$name                        = "MyUART5";
iUART3.$assign                      = "USART_5";
iUART3.CTSn.$used                   = false;
iUART3.DCDn.$used                   = false;
iUART3.DSRn.$used                   = false;
iUART3.DTRn.$used                   = false;
iUART3.RIn.$used                    = false;
iUART3.RTSn.$used                   = false;
iUART3.RXD.$assign                  = "MCAN12_RX";
iUART3.TXD.$assign                  = "MCAN12_TX";
const iUSB1                         = scripting.addPeripheral("USB");
iUSB1.$name                         = "MyUSB0";
iUSB1.DM.$assign                    = "USB0_DM";
iUSB1.DP.$assign                    = "USB0_DP";
iUSB1.DRVVBUS.$assign               = "TIMER_IO1";
iUSB1.ID.$assign                    = "USB0_ID";
iUSB1.RCALIB.$assign                = "USB0_RCALIB";
iUSB1.SSRX1N.$used                  = false;
iUSB1.SSRX1P.$used                  = false;
iUSB1.SSRX2N.$assign                = "SERDES0_RX1_N";
iUSB1.SSRX2P.$assign                = "SERDES0_RX1_P";
iUSB1.SSTX1N.$used                  = false;
iUSB1.SSTX1P.$used                  = false;
iUSB1.SSTX2N.$assign                = "SERDES0_TX1_N";
iUSB1.SSTX2P.$assign                = "SERDES0_TX1_P";
iUSB1.VBUS.$assign                  = "USB0_VBUS";
const iWKUP_GPIO1                   = scripting.addPeripheral("WKUP_GPIO");
iWKUP_GPIO1["0"].$assign            = "WKUP_GPIO0_0";
iWKUP_GPIO1["1"].$assign            = "WKUP_GPIO0_1";
iWKUP_GPIO1["2"].$assign            = "WKUP_GPIO0_2";
iWKUP_GPIO1["3"].$assign            = "WKUP_GPIO0_3";
iWKUP_GPIO1["4"].$used              = false;
iWKUP_GPIO1["5"].$used              = false;
iWKUP_GPIO1["6"].$assign            = "WKUP_GPIO0_6";
iWKUP_GPIO1["7"].$assign            = "WKUP_GPIO0_7";
iWKUP_GPIO1["8"].$used              = false;
iWKUP_GPIO1["9"].$used              = false;
iWKUP_GPIO1["10"].$used             = false;
iWKUP_GPIO1["11"].$used             = false;
iWKUP_GPIO1["12"].$used             = false;
iWKUP_GPIO1["13"].$used             = false;
iWKUP_GPIO1["14"].$used             = false;
iWKUP_GPIO1["15"].$used             = false;
iWKUP_GPIO1["16"].$used             = false;
iWKUP_GPIO1["17"].$used             = false;
iWKUP_GPIO1["18"].$used             = false;
iWKUP_GPIO1["19"].$used             = false;
iWKUP_GPIO1["20"].$used             = false;
iWKUP_GPIO1["21"].$used             = false;
iWKUP_GPIO1["22"].$used             = false;
iWKUP_GPIO1["23"].$used             = false;
iWKUP_GPIO1["24"].$used             = false;
iWKUP_GPIO1["25"].$used             = false;
iWKUP_GPIO1["26"].$used             = false;
iWKUP_GPIO1["27"].$used             = false;
iWKUP_GPIO1["28"].$used             = false;
iWKUP_GPIO1["29"].$used             = false;
iWKUP_GPIO1["30"].$used             = false;
iWKUP_GPIO1["31"].$used             = false;
iWKUP_GPIO1["32"].$used             = false;
iWKUP_GPIO1["33"].$used             = false;
iWKUP_GPIO1["34"].$used             = false;
iWKUP_GPIO1["35"].$used             = false;
iWKUP_GPIO1["36"].$used             = false;
iWKUP_GPIO1["37"].$used             = false;
iWKUP_GPIO1["38"].$used             = false;
iWKUP_GPIO1["39"].$assign           = "MCU_OSPI1_CSn1";
iWKUP_GPIO1["40"].$used             = false;
iWKUP_GPIO1["41"].$used             = false;
iWKUP_GPIO1["42"].$used             = false;
iWKUP_GPIO1["43"].$used             = false;
iWKUP_GPIO1["44"].$used             = false;
iWKUP_GPIO1["45"].$used             = false;
iWKUP_GPIO1["46"].$used             = false;
iWKUP_GPIO1["47"].$used             = false;
iWKUP_GPIO1["48"].$used             = false;
iWKUP_GPIO1["49"].$assign           = "WKUP_GPIO0_49";
iWKUP_GPIO1["50"].$used             = false;
iWKUP_GPIO1["51"].$used             = false;
iWKUP_GPIO1["52"].$used             = false;
iWKUP_GPIO1["53"].$used             = false;
iWKUP_GPIO1["54"].$assign           = "MCU_SPI0_CLK";
iWKUP_GPIO1["54"].$used             = false;
iWKUP_GPIO1["55"].$assign           = "MCU_SPI0_D0";
iWKUP_GPIO1["56"].$assign           = "WKUP_GPIO0_56";
iWKUP_GPIO1["57"].$assign           = "WKUP_GPIO0_57";
iWKUP_GPIO1["57"].$used             = false;
iWKUP_GPIO1["58"].$used             = false;
iWKUP_GPIO1["59"].$used             = false;
iWKUP_GPIO1["60"].$used             = false;
iWKUP_GPIO1["61"].$used             = false;
iWKUP_GPIO1["62"].$used             = false;
iWKUP_GPIO1["63"].$used             = false;
iWKUP_GPIO1["64"].$used             = false;
iWKUP_GPIO1["65"].$used             = false;
iWKUP_GPIO1["66"].$assign           = "WKUP_GPIO0_66";
iWKUP_GPIO1["66"].$used             = false;
iWKUP_GPIO1["67"].$used             = false;
iWKUP_GPIO1["68"].$used             = false;
iWKUP_GPIO1["69"].$assign           = "MCU_SPI0_D1";
iWKUP_GPIO1["70"].$assign           = "MCU_SPI0_CS0";
iWKUP_GPIO1["71"].$used             = false;
iWKUP_GPIO1["72"].$used             = false;
iWKUP_GPIO1["73"].$used             = false;
iWKUP_GPIO1["74"].$used             = false;
iWKUP_GPIO1["75"].$used             = false;
iWKUP_GPIO1["76"].$used             = false;
iWKUP_GPIO1["77"].$used             = false;
iWKUP_GPIO1["78"].$used             = false;
iWKUP_GPIO1["79"].$used             = false;
iWKUP_GPIO1["80"].$used             = false;
iWKUP_GPIO1["81"].$used             = false;
iWKUP_GPIO1["82"].$used             = false;
iWKUP_GPIO1["83"].$used             = false;
iWKUP_GPIO1["84"].$used             = false;
iWKUP_GPIO1["85"].$used             = false;
iWKUP_GPIO1["86"].$used             = false;
iWKUP_GPIO1["87"].$used             = false;
iWKUP_GPIO1["88"].$used             = false;
iWKUP_GPIO1.$name                   = "MyWKUP_GPIO0";
iWKUP_GPIO1.$assign                 = "WKUP_GPIO_0";
const iWKUP_I2C1                    = scripting.addPeripheral("WKUP_I2C");
iWKUP_I2C1.$name                    = "MyWKUP_I2C0";
iWKUP_I2C1.$assign                  = "WKUP_I2C_0";
iWKUP_I2C1.SCL.$assign              = "WKUP_I2C0_SCL";
iWKUP_I2C1.SDA.$assign              = "WKUP_I2C0_SDA";
const iWKUP_OSC1                    = scripting.addPeripheral("WKUP_OSC");
iWKUP_OSC1.$name                    = "MyWKUP_OSC1";
iWKUP_OSC1.$assign                  = "WKUP_OSC_0";
iWKUP_OSC1.XI.$assign               = "WKUP_OSC0_XI";
iWKUP_OSC1.XO.$assign               = "WKUP_OSC0_XO";
const iWKUP_UART1                   = scripting.addPeripheral("WKUP_UART");
iWKUP_UART1.$name                   = "MyWKUP_UART0";
iWKUP_UART1.CTSn.$used              = false;
iWKUP_UART1.RTSn.$used              = false;
iWKUP_UART1.RXD.$assign             = "WKUP_UART0_RXD";
iWKUP_UART1.TXD.$assign             = "WKUP_UART0_TXD";

/**
 * Pinmux solution for unlocked pins/peripherals. This ensures that minor changes to the automatic solver in a future
 * version of the tool will not impact the pinmux you originally saw.  These lines can be completely deleted in order to
 * re-solve from scratch.
 */
iAUXPHY1.$suggestSolution    = "AUXPHY_0";
iCSI1.$suggestSolution       = "CSI_RX_0";
iCSI2.$suggestSolution       = "CSI_RX_1";
iDP1.$suggestSolution        = "DP_0";
iMCU_ADC2.$suggestSolution   = "MCU_ADC_1";
iMCU_OSPI1.$suggestSolution  = "MCU_OSPI_0";
iMCU_OSPI2.$suggestSolution  = "MCU_OSPI_1";
iPCIE1.$suggestSolution      = "PCIE_1";
iSERDES1.$suggestSolution    = "SERDES_0";
iUSB1.$suggestSolution       = "USB_0";
iWKUP_UART1.$suggestSolution = "WKUP_USART_0";
